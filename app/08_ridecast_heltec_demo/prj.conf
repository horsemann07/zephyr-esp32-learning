## CMakeLists.txt
```
cmake_minimum_required(VERSION 3.20.0)

# Matches the OLED shield already used by our Heltec Zephyr examples.
set(SHIELD ssd1306_128x64)
find_package(Zephyr REQUIRED HINTS $ENV{ZEPHYR_BASE})
project(ridecast_heltec_demo)

set(RC_ROOT "${CMAKE_CURRENT_SOURCE_DIR}/../..")
target_include_directories(app PRIVATE
    "${RC_ROOT}/common"
    "${CMAKE_CURRENT_SOURCE_DIR}/src"
)
target_sources(app PRIVATE src/main.c src/heltec_graphic.c src/rc_err_sts.c)

if(CONFIG_RC_HELTEC_WIFI_DEMO)
    set(RC_CONNECTION_DIR "${RC_ROOT}/services/connection")
    target_include_directories(app PRIVATE "${RC_CONNECTION_DIR}")
    target_sources(app PRIVATE
        "${RC_CONNECTION_DIR}/rc_connection_wifi.c"
        "${RC_CONNECTION_DIR}/rc_connection_tcp.c"
    )
endif()
```

## Kconfig
```
mainmenu "RideCast Heltec Navigation Demo"

config RC_HELTEC_WIFI_DEMO
    bool "Enable Wi-Fi STA and development TCP navigation receiver"
    depends on WIFI && NETWORKING && NET_SOCKETS
    default n
    help
      Enable Zephyr Wi-Fi connection manager plus a TCP server on port 5050.
      Wire protocol for this demonstration is temporary ASCII test-only lines.
      Do not expose this unauthenticated test server to untrusted networks.

if RC_HELTEC_WIFI_DEMO
config RC_DEMO_WIFI_SSID
    string "Development Wi-Fi SSID"
    default ""

config RC_DEMO_WIFI_PSK
    string "Development Wi-Fi WPA2 passphrase"
    default ""
endif

source "Kconfig.zephyr"
```

## prj.conf
```kconfig
# Phase 0: SSD1306 OLED navigation UI; no networking required.
CONFIG_GPIO=y
CONFIG_I2C=y
CONFIG_DISPLAY=y
CONFIG_SSD1306=y
CONFIG_CHARACTER_FRAMEBUFFER=y
CONFIG_CHARACTER_FRAMEBUFFER_USE_DEFAULT_FONTS=y
CONFIG_HEAP_MEM_POOL_SIZE=2048
CONFIG_MAIN_STACK_SIZE=4096
CONFIG_CONSOLE=y
CONFIG_PRINTK=y
CONFIG_LOG=y
CONFIG_LOG_DEFAULT_LEVEL=3
```

## wifi.conf
```kconfig
# Phase 1: opt-in Wi-Fi STA + single-client TCP NAV demo on port 5050.
# Requires local.conf with CONFIG_RC_DEMO_WIFI_SSID/PSK.
CONFIG_NETWORKING=y
CONFIG_NET_IPV4=y
CONFIG_NET_IPV6=n
CONFIG_WIFI=y
CONFIG_NET_SOCKETS=y
CONFIG_NET_TCP=y
CONFIG_NET_DHCPV4=y
CONFIG_NET_MGMT_EVENT=y
CONFIG_SHELL=y
CONFIG_NET_SHELL=y
CONFIG_NET_L2_WIFI_SHELL=y
CONFIG_RC_HELTEC_WIFI_DEMO=y
CONFIG_SYSTEM_WORKQUEUE_STACK_SIZE=2048
CONFIG_NET_TX_STACK_SIZE=2048
CONFIG_NET_RX_STACK_SIZE=2048
```

## app.overlay
```dts
/* Heltec V2: same OLED configuration as the previously tested local samples.
 * Defer display startup until after the I2C bus recovery in heltec_graphic.c.
 */
#include <zephyr/dt-bindings/i2c/i2c.h>

&i2c0 {
    status = "okay";
    clock-frequency = <I2C_BITRATE_STANDARD>;
};

&ssd1306_ssd1306_128x64 {
    status = "okay";
    zephyr,deferred-init;
};
```

## src/main.c
```c
/* SPDX-License-Identifier: MIT
 * RideCast Heltec demo: same logical UI for mock navigation and Wi-Fi TCP.
 * Phase 0: default, no network; produces rotating sample navigation screens.
 * Phase 1: CONFIG_RC_HELTEC_WIFI_DEMO=y; uses existing connection services.
 * TCP test grammar (not the RideCast production wire protocol):
 *   PING\n                  -> PONG\n
 *   NAV,RIGHT,250,35,1\n   -> ACK,NAV\n
 */
#include <zephyr/kernel.h>
#include <zephyr/sys/printk.h>
#include <stdint.h>
#include <stdbool.h>
#include <stdio.h>
#include <string.h>

#include "heltec_graphic.h"

#define DEMO_FRAME_MS 3500U
#define UI_TICK_MS    200U

#ifdef CONFIG_RC_HELTEC_WIFI_DEMO
    #include "rc_connection_wifi.h"
    #include "rc_connection_tcp.h"

    #define RC_RX_LINE_MAX 96U
K_MSGQ_DEFINE(nav_queue, sizeof(heltec_nav_screen_t), 4, 4);
static char rx_line[RC_RX_LINE_MAX];
static size_t rx_used;
static bool rx_dropping;

static void wifi_status_changed(const rc_conn_wifi_snapshot_t* s, void* user)
{
    ARG_UNUSED(user);
    printk("[Wi-Fi] %s attempt=%u err=%d\n", rc_conn_wifi_state_name(s->state),
           (unsigned int)s->attempts, (int)s->last_error);
}

static void peer_changed(bool connected, void* user)
{
    ARG_UNUSED(user);
    /* Callback runs in TCP worker thread. Only worker manipulates rx_line.
     * recv data callbacks from this worker are not concurrent.
     */
    rx_used     = 0U;
    rx_dropping = false;
    printk("[TCP] peer %s\n", connected ? "connected" : "disconnected");
}

static bool decode_nav_line(const char* line, heltec_nav_screen_t* out)
{
    char dir[16];
    char trailing;
    unsigned int meters = 0U, speed = 0U, gps = 0U;
    /* The extra %c rejects trailing garbage rather than accepting it. */
    int count =
    sscanf(line, "NAV,%15[^,],%u,%u,%u%c", dir, &meters, &speed, &gps, &trailing);
    if(count != 4 || meters > 9999U || speed > 240U || gps > 1U)
    {
        return false;
    }
    heltec_turn_t turn;
    if(strcmp(dir, "RIGHT") == 0)
    {
        turn = HELTEC_TURN_RIGHT;
    }
    else if(strcmp(dir, "LEFT") == 0)
    {
        turn = HELTEC_TURN_LEFT;
    }
    else if(strcmp(dir, "STRAIGHT") == 0)
    {
        turn = HELTEC_TURN_STRAIGHT;
    }
    else if(strcmp(dir, "ARRIVED") == 0)
    {
        turn = HELTEC_TURN_ARRIVED;
    }
    else
    {
        return false;
    }
    *out = (heltec_nav_screen_t){ .turn       = turn,
                                  .link       = HELTEC_LINK_ONLINE,
                                  .distance_m = (uint16_t)meters,
                                  .speed_kmh  = (uint16_t)speed,
                                  .gps_valid  = gps == 1U };
    return true;
}

static void send_response(const char* text)
{
    rc_err_sts_t rc = rc_conn_tcp_send((const uint8_t*)text, strlen(text));
    if(rc != RC_OK)
    {
        printk("[TCP] response failed: %d\n", (int)rc);
    }
}

static void dispatch_test_line(char* line)
{
    if(strcmp(line, "PING") == 0)
    {
        send_response("PONG\n");
        return;
    }
    heltec_nav_screen_t update;
    if(decode_nav_line(line, &update))
    {
        /* Never draw from a networking callback. UI thread reads the queue. */
        if(k_msgq_put(&nav_queue, &update, K_NO_WAIT) != 0)
        {
            heltec_nav_screen_t ignored;
            (void)k_msgq_get(&nav_queue, &ignored, K_NO_WAIT);
            (void)k_msgq_put(&nav_queue, &update, K_NO_WAIT);
        }
        send_response("ACK,NAV\n");
    }
    else
    {
        send_response("ERR,FORMAT\n");
    }
}

static void tcp_bytes_received(const uint8_t* data, size_t len, void* user)
{
    ARG_UNUSED(user);
    /* TCP is a byte stream: one receive may hold partial or many lines. */
    for(size_t i = 0U; i < len; ++i)
    {
        const char ch = (char)data[i];
        if(ch == '\n')
        {
            if(rx_dropping)
            {
                send_response("ERR,TOO_LONG\n");
            }
            else
            {
                if(rx_used > 0U && rx_line[rx_used - 1U] == '\r')
                {
                    --rx_used;
                }
                rx_line[rx_used] = '\0';
                dispatch_test_line(rx_line);
            }
            rx_used     = 0U;
            rx_dropping = false;
        }
        else if(!rx_dropping)
        {
            if((unsigned char)ch < 32U || (unsigned char)ch > 126U)
            {
                rx_dropping = true;
            }
            else if(rx_used + 1U < sizeof(rx_line))
            {
                rx_line[rx_used++] = ch;
            }
            else
            {
                rx_dropping = true;
            }
        }
    }
}

static bool start_wifi_demo(void)
{
    if(CONFIG_RC_DEMO_WIFI_SSID[0] == '\0' || CONFIG_RC_DEMO_WIFI_PSK[0] == '\0')
    {
        printk("[Wi-Fi] Configure SSID/PSK in untracked local.conf\n");
        return false;
    }
    const rc_conn_wifi_config_t cfg    = { .ssid = CONFIG_RC_DEMO_WIFI_SSID,
                                           .psk  = CONFIG_RC_DEMO_WIFI_PSK,
                                           .open_network       = false,
                                           .retry_delay_ms     = 3000U,
                                           .connect_timeout_ms = 15000U,
                                           .max_attempts       = 0U };
    const rc_conn_tcp_config_t tcp_cfg = { .listen_port = 5050U };
    rc_err_sts_t st = rc_conn_wifi_init(&cfg, wifi_status_changed, NULL);
    if(st != RC_OK)
    {
        printk("[Wi-Fi] init error=%d\n", (int)st);
        return false;
    }
    st = rc_conn_tcp_init(&tcp_cfg, tcp_bytes_received, peer_changed, NULL);
    if(st != RC_OK)
    {
        printk("[TCP] init error=%d\n", (int)st);
        return false;
    }
    st = rc_conn_wifi_start();
    if(st != RC_OK)
    {
        printk("[Wi-Fi] start error=%d\n", (int)st);
        return false;
    }
    st = rc_conn_tcp_start();
    if(st != RC_OK)
    {
        printk("[TCP] start error=%d\n", (int)st);
        return false;
    }
    printk("[TCP] development NAV protocol on port 5050\n");
    return true;
}
#endif /* CONFIG_RC_HELTEC_WIFI_DEMO */

int main(void)
{
    rc_err_sts_t st = heltec_graphic_init();
    if(st != RC_OK)
    {
        printk("RideCast OLED init error=%d\n", (int)st);
        return 0;
    }
    printk("RideCast Heltec 128x64 demo ready\n");

    heltec_nav_screen_t ui = { .turn       = HELTEC_TURN_RIGHT,
                               .link       = HELTEC_LINK_DEMO,
                               .distance_m = 250U,
                               .speed_kmh  = 35U,
                               .gps_valid  = true };

#ifdef CONFIG_RC_HELTEC_WIFI_DEMO
    /* No simulated ONLINE status: live mode starts offline until Wi-Fi and
     * the TCP test peer are actually connected. */
    ui.turn       = HELTEC_TURN_NONE;
    ui.link       = HELTEC_LINK_OFFLINE;
    ui.distance_m = 0U;
    ui.speed_kmh  = 0U;
    ui.gps_valid  = false;
    (void)start_wifi_demo();
    int64_t last_nav_ms = -1;
#else
    static const heltec_nav_screen_t frames[] = { { .turn = HELTEC_TURN_RIGHT,
                                                    .link = HELTEC_LINK_DEMO,
                                                    .distance_m = 250U,
                                                    .speed_kmh  = 35U,
                                                    .gps_valid  = true },
                                                  { .turn = HELTEC_TURN_STRAIGHT,
                                                    .link = HELTEC_LINK_DEMO,
                                                    .distance_m = 900U,
                                                    .speed_kmh  = 42U,
                                                    .gps_valid  = true },
                                                  { .turn = HELTEC_TURN_LEFT,
                                                    .link = HELTEC_LINK_DEMO,
                                                    .distance_m = 120U,
                                                    .speed_kmh  = 24U,
                                                    .gps_valid  = true },
                                                  { .turn = HELTEC_TURN_ARRIVED,
                                                    .link = HELTEC_LINK_DEMO,
                                                    .distance_m = 0U,
                                                    .speed_kmh  = 0U,
                                                    .gps_valid  = true } };
    size_t next_frame     = 1U;
    int64_t next_frame_ms = k_uptime_get() + DEMO_FRAME_MS;
#endif

    /* One thread owns all CFB operations. Incoming network data is queued. */
    (void)heltec_graphic_render(&ui);
    while(true)
    {
        bool changed = false;
#ifdef CONFIG_RC_HELTEC_WIFI_DEMO
        heltec_nav_screen_t update;
        while(k_msgq_get(&nav_queue, &update, K_NO_WAIT) == 0)
        {
            ui.turn       = update.turn;
            ui.distance_m = update.distance_m;
            ui.speed_kmh  = update.speed_kmh;
            ui.gps_valid  = update.gps_valid;
            last_nav_ms   = k_uptime_get();
            changed       = true;
        }
        heltec_link_t current_link = HELTEC_LINK_OFFLINE;
        if(rc_conn_wifi_is_connected())
        {
            current_link = rc_conn_tcp_peer_connected() ? HELTEC_LINK_ONLINE : HELTEC_LINK_WIFI;
        }
        if(ui.link != current_link)
        {
            ui.link = current_link;
            /* A disconnected peer must not retain a "GPS:OK" indicator. */
            if(current_link != HELTEC_LINK_ONLINE)
            {
                ui.gps_valid = false;
            }
            changed = true;
        }
        if(last_nav_ms >= 0 && (k_uptime_get() - last_nav_ms) > 5000 && ui.gps_valid)
        {
            ui.gps_valid = false; /* Stale data must not claim valid GPS. */
            changed      = true;
        }
#else
        if(k_uptime_get() >= next_frame_ms)
        {
            ui = frames[next_frame];
            next_frame = (next_frame + 1U) % (sizeof(frames) / sizeof(frames[0]));
            next_frame_ms = k_uptime_get() + DEMO_FRAME_MS;
            changed       = true;
        }
#endif
        if(changed)
        {
            st = heltec_graphic_render(&ui);
            if(st != RC_OK)
            {
                printk("RideCast render error=%d\n", (int)st);
            }
        }
        k_msleep(UI_TICK_MS);
    }
    return 0;
}
```

## src/heltec_graphic.c
```c
/* SPDX-License-Identifier: MIT
 * Monochrome RideCast screen for the Heltec V2 128x64 SSD1306.
 * Tested initialization sequence taken from the project's prior OLED samples:
 * I2C recovery -> deferred device_init -> CFB -> display unblank.
 */
#include "heltec_graphic.h"

#include <zephyr/device.h>
#include <zephyr/devicetree.h>
#include <zephyr/drivers/display.h>
#include <zephyr/drivers/i2c.h>
#include <zephyr/display/cfb.h>
#include <zephyr/sys/printk.h>
#include <errno.h>
#include <stdbool.h>
#include <stddef.h>
#include <stdint.h>
#include <stdio.h>
#include <string.h>

#define RC_OLED_W 128
#define RC_OLED_H 64
/* Reserve a right margin and a bottom margin for real-panel alignment. */
#define RC_UI_RIGHT 112
#define RC_UI_BOTTOM 60
#define RC_I2C_NODE DT_NODELABEL(i2c0)

#if !DT_HAS_CHOSEN(zephyr_display)
#error "Select shield ssd1306_128x64 (zephyr,display missing)"
#endif
#define RC_OLED_NODE DT_CHOSEN(zephyr_display)
#if !DT_NODE_HAS_STATUS(RC_I2C_NODE, okay)
#error "Heltec I2C0 must be enabled in app.overlay"
#endif
#if !DT_NODE_HAS_STATUS(RC_OLED_NODE, okay)
#error "SSD1306 must be enabled in app.overlay"
#endif
#if !DT_PROP(RC_OLED_NODE, zephyr_deferred_init)
#error "SSD1306 needs zephyr,deferred-init in app.overlay"
#endif

static const struct device *const i2c_dev = DEVICE_DT_GET(RC_I2C_NODE);
static const struct device *const oled_dev = DEVICE_DT_GET(RC_OLED_NODE);
static bool initialized;
static uint8_t font_width = 8;
static uint8_t font_height = 8;

#define DRAW_CHECK(expression) do { int _rc = (expression); if (_rc < 0) return _rc; } while (0)

static int draw_line(int x0, int y0, int x1, int y1)
{
    const struct cfb_position a = { (int16_t)x0, (int16_t)y0 };
    const struct cfb_position b = { (int16_t)x1, (int16_t)y1 };
    return cfb_draw_line(oled_dev, &a, &b);
}

/* Never send a line longer than the available pixels to the CFB driver. */
static int draw_text(const char *s, int x, int y)
{
    char out[24];
    size_t max_chars;
    size_t n;
    if (s == NULL || x < 0 || x >= RC_UI_RIGHT || y < 0 ||
        y + font_height > RC_UI_BOTTOM || font_width == 0U) {
        return -EINVAL;
    }
    max_chars = (size_t)(RC_UI_RIGHT - x) / font_width;
    if (max_chars > sizeof(out) - 1U) {
        max_chars = sizeof(out) - 1U;
    }
    n = strlen(s);
    if (n > max_chars) {
        n = max_chars;
    }
    memcpy(out, s, n);
    out[n] = '\0';
    return cfb_print(oled_dev, out, (int16_t)x, (int16_t)y);
}

/* v0.5 screen layout, physical SSD1306 pixels (128x64):
 *   mini header "RC" + "SIM/OFF/WIFI/ONLINE"  y=3..7
 *   arrow and 7-segment distance             y=16..36
 *   turn instruction (Zephyr CFB font)       y=39..46
 *   speed (CFB font)                        y=50..57
 *   GPS: (3x5 micro-font) + OK/NO (CFB)     y=50..57
 *
 * Intentionally NO horizontal separator lines. The GPS status is intentionally
 * a separate, fixed-width field so it never collides with speed at 240km/h.
 * Leave 16px from the right edge and 6px from the bottom.
 */

/* 3x5 micro-font used ONLY for the tiny top-left/right status labels.
 * The main instruction, speed and distance font sizes are unchanged.
 * Each row is a 3-bit mask (bit 2 is leftmost pixel).
 */
static const uint8_t *micro_glyph(char ch)
{
    static const uint8_t glyph_r[5] = { 6, 5, 6, 5, 5 };
    static const uint8_t glyph_c[5] = { 3, 4, 4, 4, 3 };
    static const uint8_t glyph_s[5] = { 3, 4, 2, 1, 6 };
    static const uint8_t glyph_i[5] = { 7, 2, 2, 2, 7 };
    static const uint8_t glyph_m[5] = { 5, 7, 7, 5, 5 };
    static const uint8_t glyph_o[5] = { 2, 5, 5, 5, 2 };
    static const uint8_t glyph_f[5] = { 7, 4, 6, 4, 4 };
    static const uint8_t glyph_w[5] = { 5, 5, 7, 7, 5 };
    static const uint8_t glyph_n[5] = { 5, 7, 7, 7, 5 };
    static const uint8_t glyph_l[5] = { 4, 4, 4, 4, 7 };
    static const uint8_t glyph_e[5] = { 7, 4, 6, 4, 7 };
    static const uint8_t glyph_g[5] = { 3, 4, 5, 5, 3 };
    static const uint8_t glyph_p[5] = { 6, 5, 6, 4, 4 };
    static const uint8_t glyph_colon[5] = { 0, 2, 0, 2, 0 };
    switch (ch) {
    case 'R': return glyph_r;
    case 'C': return glyph_c;
    case 'S': return glyph_s;
    case 'I': return glyph_i;
    case 'M': return glyph_m;
    case 'O': return glyph_o;
    case 'F': return glyph_f;
    case 'W': return glyph_w;
    case 'N': return glyph_n;
    case 'L': return glyph_l;
    case 'E': return glyph_e;
    case 'G': return glyph_g;
    case 'P': return glyph_p;
    case ':': return glyph_colon;
    default:  return NULL;
    }
}

static int draw_micro_text(const char *text, int x, int y)
{
    if (text == NULL || x < 0 || y < 0) {
        return -EINVAL;
    }
    size_t count = strlen(text);
    /* each glyph is 3 wide; inter-character gap is 1 pixel */
    if (count == 0U || count > 16U ||
        x + (int)(count * 4U - 1U) > RC_UI_RIGHT || y + 5 > RC_UI_BOTTOM) {
        return -EINVAL;
    }
    for (size_t i = 0U; i < count; ++i) {
        const uint8_t *g = micro_glyph(text[i]);
        if (g == NULL) {
            return -EINVAL;
        }
        const int gx = x + (int)(i * 4U);
        for (int row = 0; row < 5; ++row) {
            for (int col = 0; col < 3; ++col) {
                if ((g[row] & (uint8_t)(4U >> col)) != 0U) {
                    DRAW_CHECK(draw_line(gx + col, y + row,
                                         gx + col, y + row));
                }
            }
        }
    }
    return 0;
}

static int segment(int x0, int y0, uint8_t which)
{
    switch (which) {
    case 0: return draw_line(x0 + 2, y0,     x0 + 9,  y0);       /* top */
    case 1: return draw_line(x0 + 10,y0 + 1, x0 + 10, y0 + 8);  /* top right */
    case 2: return draw_line(x0 + 10,y0 + 10,x0 + 10, y0 + 17); /* bottom right */
    case 3: return draw_line(x0 + 2, y0 + 18,x0 + 9, y0 + 18);  /* bottom */
    case 4: return draw_line(x0 + 1, y0 + 10,x0 + 1, y0 + 17);  /* bottom left */
    case 5: return draw_line(x0 + 1, y0 + 1, x0 + 1, y0 + 8);   /* top left */
    case 6: return draw_line(x0 + 2, y0 + 9, x0 + 9, y0 + 9);   /* middle */
    default: return -EINVAL;
    }
}

static int big_digit(uint8_t digit, int x, int y)
{
    static const uint8_t bitmap[] = {
        0x3f, /* 0: A B C D E F */
        0x06, /* 1: B C */
        0x5b, /* 2: A B D E G */
        0x4f, /* 3: A B C D G */
        0x66, /* 4: B C F G */
        0x6d, /* 5: A C D F G */
        0x7d, /* 6: A C D E F G */
        0x07, /* 7: A B C */
        0x7f, /* 8: all */
        0x6f  /* 9: A B C D F G */
    };
    if (digit > 9U) {
        return -EINVAL;
    }
    for (uint8_t seg = 0; seg < 7U; ++seg) {
        if ((bitmap[digit] & (1U << seg)) != 0U) {
            DRAW_CHECK(segment(x, y, seg));
        }
    }
    return 0;
}

static int draw_distance(uint16_t meters)
{
    if (meters > 999U) {
        meters = 999U; /* display limit; underlying model is unchanged */
    }

    /* Center the complete number + unit in the 50..126 pixel region. */
    const int digits = (meters >= 100U) ? 3 : (meters >= 10U ? 2 : 1);
    int x = (digits == 3) ? 50 : (digits == 2 ? 64 : 78);
    if (meters >= 100U) {
        DRAW_CHECK(big_digit((uint8_t)(meters / 100U), x, 16));
        x += 14;
    }
    if (meters >= 10U) {
        DRAW_CHECK(big_digit((uint8_t)((meters / 10U) % 10U), x, 16));
        x += 14;
    }
    DRAW_CHECK(big_digit((uint8_t)(meters % 10U), x, 16));
    x += 15;
    return draw_text("m", x, 22);
}

static int draw_turn_icon(heltec_turn_t turn)
{
    switch (turn) {
    case HELTEC_TURN_RIGHT:
        DRAW_CHECK(draw_line(12, 36, 12, 26));
        DRAW_CHECK(draw_line(12, 26, 35, 26));
        DRAW_CHECK(draw_line(35, 26, 27, 18));
        return draw_line(35, 26, 27, 34);
    case HELTEC_TURN_LEFT:
        DRAW_CHECK(draw_line(35, 36, 35, 26));
        DRAW_CHECK(draw_line(35, 26, 12, 26));
        DRAW_CHECK(draw_line(12, 26, 20, 18));
        return draw_line(12, 26, 20, 34);
    case HELTEC_TURN_STRAIGHT:
        DRAW_CHECK(draw_line(24, 36, 24, 17));
        DRAW_CHECK(draw_line(24, 17, 16, 25));
        return draw_line(24, 17, 32, 25);
    case HELTEC_TURN_ARRIVED:
        DRAW_CHECK(draw_line(12, 27, 20, 36));
        return draw_line(20, 36, 37, 17);
    case HELTEC_TURN_NONE:
        DRAW_CHECK(draw_line(18, 20, 29, 20));
        DRAW_CHECK(draw_line(29, 20, 29, 28));
        return draw_line(24, 33, 24, 35);
    default:
        return -EINVAL;
    }
}

static void select_compact_font(void)
{
    int best = -1;
    uint8_t best_w = 255U;
    uint8_t best_h = 255U;
    int font_count = cfb_get_numof_fonts(oled_dev);
    for (int i = 0; i < font_count; ++i) {
        uint8_t w = 0U;
        uint8_t h = 0U;
        if (cfb_get_font_size(oled_dev, (uint8_t)i, &w, &h) == 0 &&
            w > 0U && w <= 8U && h > 0U && h <= 8U &&
            (best < 0 || w < best_w || (w == best_w && h < best_h))) {
            best = i;
            best_w = w;
            best_h = h;
        }
    }
    if (best >= 0 && cfb_framebuffer_set_font(oled_dev, (uint8_t)best) == 0) {
        font_width = best_w;
        font_height = best_h;
    }
    printk("RideCast OLED font %ux%u\n", font_width, font_height);
}

rc_err_sts_t heltec_graphic_init(void)
{
    if (initialized) {
        return RC_ERR_ALREADY_INITIALIZED;
    }
    if (!device_is_ready(i2c_dev)) {
        return RC_ERR_NOT_READY;
    }
    int status = i2c_recover_bus(i2c_dev);
    if (status < 0) {
        printk("OLED I2C recovery failed: %d\n", status);
        return RC_ERR_IO;
    }
    status = device_init(oled_dev);
    if (status < 0 || !device_is_ready(oled_dev)) {
        printk("OLED device initialization failed: %d\n", status);
        return RC_ERR_INIT_FAILED;
    }
    status = display_set_pixel_format(oled_dev, PIXEL_FORMAT_MONO01);
    if (status < 0) {
        return RC_ERR_NOT_SUPPORTED;
    }
    status = cfb_framebuffer_init(oled_dev);
    if (status < 0) {
        return RC_ERR_INIT_FAILED;
    }
    select_compact_font();
    status = cfb_framebuffer_clear(oled_dev, false);
    if (status < 0 || display_blanking_off(oled_dev) < 0) {
        return RC_ERR_IO;
    }
    initialized = true;
    return RC_OK;
}

rc_err_sts_t heltec_graphic_render(const heltec_nav_screen_t *screen)
{
    if (!initialized) {
        return RC_ERR_NOT_INITIALIZED;
    }
    if (screen == NULL || screen->turn > HELTEC_TURN_ARRIVED ||
        screen->link > HELTEC_LINK_ONLINE || screen->speed_kmh > 240U) {
        return RC_ERR_INVALID_ARG;
    }
    const char *link_label;
    switch (screen->link) {
    case HELTEC_LINK_DEMO:    link_label = "SIM"; break;
    case HELTEC_LINK_OFFLINE: link_label = "OFF"; break;
    case HELTEC_LINK_WIFI:    link_label = "WIFI"; break;
    case HELTEC_LINK_ONLINE:  link_label = "ONLINE"; break;
    default:                 return RC_ERR_INVALID_ARG;
    }
    const char *turn_label;
    switch (screen->turn) {
    case HELTEC_TURN_RIGHT:    turn_label = "TURN RIGHT"; break;
    case HELTEC_TURN_LEFT:     turn_label = "TURN LEFT"; break;
    case HELTEC_TURN_STRAIGHT: turn_label = "STRAIGHT"; break;
    case HELTEC_TURN_ARRIVED:  turn_label = "ARRIVED"; break;
    case HELTEC_TURN_NONE:     turn_label = "WAIT NAV"; break;
    default:                   return RC_ERR_INVALID_ARG;
    }
    char footer[20];
    (void)snprintf(footer, sizeof(footer), "%ukm/h", (unsigned int)screen->speed_kmh);

    /* Small permanent product label; no debug version or separator lines. */
    const char *heading = "RC";
    const char *gps_result = screen->gps_valid ? "OK" : "NO";
    /* 3x5 micro-font has a four-pixel character pitch. */
    const int link_x = RC_UI_RIGHT - 4 - (int)(4U * strlen(link_label) - 1U);
    /* Physical layout measured on the real Heltec panel:
     *   speed: x=4..59 at maximum "240km/h" with an 8px CFB font
     *   GPS:   x=75..89 (3x5) -- clearly separated from speed
     *   OK/NO: x=96..111 (CFB) -- ends 16px before physical edge
     */
    const int gps_micro_x = 75;
    const int gps_result_x = RC_UI_RIGHT - (int)(font_width * strlen(gps_result));

    int status = cfb_framebuffer_clear(oled_dev, false);
    if (status >= 0) status = draw_micro_text(heading, 4, 3);
    if (status >= 0) status = draw_micro_text(link_label, link_x, 3);
    if (status >= 0) status = draw_turn_icon(screen->turn);
    if (status >= 0) status = draw_distance(screen->distance_m);
    /* Instruction now has its OWN full-width row, not beside the digits. */
    if (status >= 0) status = draw_text(turn_label, 4, 39);
    if (status >= 0) status = draw_text(footer, 4, 50);
    if (status >= 0) status = draw_micro_text("GPS:", gps_micro_x, 52);
    if (status >= 0) status = draw_text(gps_result, gps_result_x, 50);
    if (status >= 0) status = cfb_framebuffer_finalize(oled_dev);
    return status < 0 ? RC_ERR_IO : RC_OK;
}
```

## src/heltec_graphic.h
```c
/* SPDX-License-Identifier: MIT
 * RideCast Heltec 128x64 OLED navigation UI (Zephyr CFB / SSD1306).
 * Graphics layer only: no Wi-Fi, TCP, phone, or RideCast protocol dependency.
 */
#ifndef HELTEC_GRAPHIC_H_
#define HELTEC_GRAPHIC_H_

#include <stdbool.h>
#include <stdint.h>
#include "rc_err_sts.h"

#ifdef __cplusplus
extern "C" {
#endif

typedef enum {
    HELTEC_TURN_NONE = 0,
    HELTEC_TURN_STRAIGHT,
    HELTEC_TURN_LEFT,
    HELTEC_TURN_RIGHT,
    HELTEC_TURN_ARRIVED
} heltec_turn_t;

typedef enum {
    HELTEC_LINK_DEMO = 0, /* No radio connection: locally generated samples */
    HELTEC_LINK_OFFLINE,  /* Wi-Fi unavailable */
    HELTEC_LINK_WIFI,     /* Associated to AP, no TCP peer */
    HELTEC_LINK_ONLINE    /* Wi-Fi associated and demo TCP peer connected */
} heltec_link_t;

typedef struct {
    heltec_turn_t turn;
    heltec_link_t link;
    uint16_t distance_m;    /* On-screen distance is capped at 999 m */
    uint16_t speed_kmh;     /* 0...240 */
    bool gps_valid;
} heltec_nav_screen_t;

/* Must be called once, from thread context, before render(). */
rc_err_sts_t heltec_graphic_init(void);

/* Only the application/UI thread may call this function.
 * Uses a full back-buffer and one finalize() per frame.
 * v0.5: uncluttered footer: speed | GPS: OK/NO, no separator lines.
 */
rc_err_sts_t heltec_graphic_render(const heltec_nav_screen_t *screen);

#ifdef __cplusplus
}
#endif
#endif /* HELTEC_GRAPHIC_H_ */
```

## src/rc_err_sts.c
```c
/* ============================================================================
 * File        : rc_err_sts.c
 * Project     : RideCast
 * Description : Symbolic error-name lookup generated from rc_err_sts.h.
 * ========================================================================== */
#include "rc_err_sts.h"

const char *rc_err_sts_to_str(rc_err_sts_t status)
{
    switch (status) {
#define RC_ERR_STS_CASE(name, value) case name: return #name;
        RC_ERR_STS_LIST(RC_ERR_STS_CASE)
#undef RC_ERR_STS_CASE
    default:
        return "RC_ERR_UNRECOGNIZED";
    }
}
```

## src/rc_err_sts.h
```c
/* ============================================================================
 * File        : rc_err_sts.h
 * Project     : RideCast
 * Description : Single source of truth for shared API error/status codes.
 * Standard    : ISO C11; no RTOS, HAL, or heap dependency.
 *
 * Contract:
 *   RC_OK = 0              Success
 *   RC_ERR_* < 0           Failure (including expected/recoverable errors)
 *   Positive integers     NOT used for rc_err_sts_t.
 *
 * Existing error values -1 through -29 are retained for source compatibility.
 * Do not renumber published values. Append only new unused negative values.
 * These are LOCAL API results, not automatically network/wire error codes.
 * Do not log authentication secrets when reporting statuses.
 *
 * This X-macro master list drives both enum generation and string conversion.
 * ========================================================================== */
#ifndef RC_ERR_STS_H_
#define RC_ERR_STS_H_

#ifdef __cplusplus
extern "C"
{
#endif

    // clang-format off
/* Stable existing status values: do not renumber. */
#define RC_ERR_STS_BASE_LIST(X) \
    X(RC_OK                                  ,    0) \
    X(RC_ERR_INVALID_ARG                     ,   -1) \
    X(RC_ERR_NO_SPACE                        ,   -2) \
    X(RC_ERR_INVALID_FRAME                   ,   -3) \
    X(RC_ERR_UNSUPPORTED_VERSION             ,   -4) \
    X(RC_ERR_CRC_MISMATCH                    ,   -5) \
    X(RC_ERR_INVALID_TLV                     ,   -6) \
    X(RC_ERR_OVERFLOW                        ,   -7) \
    X(RC_ERR_INVALID_UTF8                    ,   -8) \
    X(RC_ERR_NOT_FOUND                       ,   -9) \
    X(RC_ERR_DUPLICATE                       ,  -10) \
    X(RC_ERR_TIMEOUT                         ,  -11) \
    X(RC_ERR_BUSY                            ,  -12) \
    X(RC_ERR_NOT_READY                       ,  -13) \
    X(RC_ERR_NOT_SUPPORTED                   ,  -14) \
    X(RC_ERR_IO                              ,  -15) \
    X(RC_ERR_DISCONNECTED                    ,  -16) \
    X(RC_ERR_AUTH_FAILED                     ,  -17) \
    X(RC_ERR_PERMISSION_DENIED               ,  -18) \
    X(RC_ERR_REPLAY_DETECTED                 ,  -19) \
    X(RC_ERR_INVALID_STATE                   ,  -20) \
    X(RC_ERR_NO_MEMORY                       ,  -21) \
    X(RC_ERR_CANCELED                        ,  -22) \
    X(RC_ERR_STORAGE                         ,  -23) \
    X(RC_ERR_STORAGE_CORRUPT                 ,  -24) \
    X(RC_ERR_RADIO                           ,  -25) \
    X(RC_ERR_NOT_REGISTERED                  ,  -26) \
    X(RC_ERR_ALREADY_EXISTS                  ,  -27) \
    X(RC_ERR_RETRY_LIMIT                     ,  -28) \
    X(RC_ERR_INTERNAL                        ,  -29)

/* Additional general errors (-30 to -49). */
#define RC_ERR_STS_COMMON_LIST(X) \
    X(RC_ERR_FAIL                            ,  -30) \
    X(RC_ERR_UNKNOWN                         ,  -31) \
    X(RC_ERR_INVALID_SIZE                    ,  -32) \
    X(RC_ERR_INVALID_LENGTH                  ,  -33) \
    X(RC_ERR_NOT_EXIST                       ,  -34) \
    X(RC_ERR_ALREADY_INITIALIZED             ,  -35) \
    X(RC_ERR_NOT_INITIALIZED                 ,  -36) \
    X(RC_ERR_INIT_FAILED                     ,  -37) \
    X(RC_ERR_DEINIT_FAILED                   ,  -38) \
    X(RC_ERR_CONFIG_FAILED                   ,  -39) \
    X(RC_ERR_OPERATION_FAILED                ,  -40) \
    X(RC_ERR_OPERATION_ABORTED               ,  -41) \
    X(RC_ERR_RESOURCE_UNAVAILABLE            ,  -42) \
    X(RC_ERR_RESOURCE_EXHAUSTED              ,  -43) \
    X(RC_ERR_BUFFER_UNDERRUN                 ,  -44) \
    X(RC_ERR_BUFFER_EMPTY                    ,  -45) \
    X(RC_ERR_BUFFER_FULL                     ,  -46) \
    X(RC_ERR_OUT_OF_BOUNDS                   ,  -47) \
    X(RC_ERR_INVALID_HANDLE                  ,  -48) \
    X(RC_ERR_INVALID_ID                      ,  -49)

/* Transport and wire-protocol errors (-50 to -79). */
#define RC_ERR_STS_COMM_LIST(X) \
    X(RC_ERR_TX_FAILED                       ,  -50) \
    X(RC_ERR_RX_FAILED                       ,  -51) \
    X(RC_ERR_TX_TIMEOUT                      ,  -52) \
    X(RC_ERR_RX_TIMEOUT                      ,  -53) \
    X(RC_ERR_TX_BUSY                         ,  -54) \
    X(RC_ERR_RX_BUSY                         ,  -55) \
    X(RC_ERR_NO_DATA                         ,  -56) \
    X(RC_ERR_NO_RESPONSE                     ,  -57) \
    X(RC_ERR_FRAME_ERROR                     ,  -58) \
    X(RC_ERR_PROTOCOL_ERROR                  ,  -59) \
    X(RC_ERR_CHECKSUM_MISMATCH               ,  -60) \
    X(RC_ERR_ACK_FAILED                      ,  -61) \
    X(RC_ERR_BUS_ERROR                       ,  -62) \
    X(RC_ERR_LINK_ERROR                      ,  -63) \
    X(RC_ERR_CONNECTION_FAILED               ,  -64) \
    X(RC_ERR_DATA_OVERFLOW                   ,  -65) \
    X(RC_ERR_DATA_UNDERRUN                   ,  -66) \
    X(RC_ERR_SYNC_FAILED                     ,  -67) \
    X(RC_ERR_TRANSPORT_NOT_OPEN              ,  -68) \
    X(RC_ERR_TRANSPORT_NOT_CONFIGURED        ,  -69) \
    X(RC_ERR_PARTIAL_WRITE                   ,  -70) \
    X(RC_ERR_FRAMING_DESYNC                  ,  -71) \
    X(RC_ERR_INVALID_MESSAGE_ID              ,  -72) \
    X(RC_ERR_INVALID_MESSAGE_KIND            ,  -73) \
    X(RC_ERR_INVALID_FLAGS                   ,  -74) \
    X(RC_ERR_INVALID_SEQUENCE                ,  -75) \
    X(RC_ERR_UNSUPPORTED_ENCODING            ,  -76) \
    X(RC_ERR_MESSAGE_TOO_LARGE               ,  -77) \
    X(RC_ERR_STREAM_RESYNC_FAILED            ,  -78) \
    X(RC_ERR_FLOW_CONTROL                    ,  -79)

/* Network, Wi-Fi, BLE and channel errors (-80 to -109). */
#define RC_ERR_STS_NETWORK_LIST(X) \
    X(RC_ERR_ALREADY_CONNECTED               ,  -80) \
    X(RC_ERR_ALREADY_DISCONNECTED            ,  -81) \
    X(RC_ERR_CONNECTION_LOST                 ,  -82) \
    X(RC_ERR_CONNECTION_TIMEOUT              ,  -83) \
    X(RC_ERR_PEER_UNAVAILABLE                ,  -84) \
    X(RC_ERR_NETWORK_UNAVAILABLE             ,  -85) \
    X(RC_ERR_NOT_CONNECTED                   ,  -86) \
    X(RC_ERR_CHANNEL_BUSY                    ,  -87) \
    X(RC_ERR_LINK_NOT_READY                  ,  -88) \
    X(RC_ERR_LINK_UNSTABLE                   ,  -89) \
    X(RC_ERR_DISCOVERY_FAILED                ,  -90) \
    X(RC_ERR_HANDSHAKE_FAILED                ,  -91) \
    X(RC_ERR_ADDRESS_INVALID                 ,  -92) \
    X(RC_ERR_ENDPOINT_UNAVAILABLE            ,  -93) \
    X(RC_ERR_WIFI_UNAVAILABLE                ,  -94) \
    X(RC_ERR_BLE_UNAVAILABLE                 ,  -95) \
    X(RC_ERR_RADIO_INIT_FAILED               ,  -96) \
    X(RC_ERR_RADIO_START_FAILED              ,  -97) \
    X(RC_ERR_RADIO_STOP_FAILED               ,  -98) \
    X(RC_ERR_RADIO_DISABLED                  ,  -99) \
    X(RC_ERR_NETWORK_CONFIG_INVALID          , -100) \
    X(RC_ERR_NETWORK_AUTH_REQUIRED           , -101) \
    X(RC_ERR_PHONE_IDENTITY_MISMATCH         , -102) \
    X(RC_ERR_WIFI_BLE_BINDING_FAILED         , -103) \
    X(RC_ERR_BLE_BOND_MISSING                , -104) \
    X(RC_ERR_PHONE_NOT_DISCOVERABLE          , -105) \
    X(RC_ERR_ROUTE_UNAVAILABLE               , -106) \
    X(RC_ERR_NOT_SUBSCRIBED                  , -107) \
    X(RC_ERR_CHANNEL_LOST                    , -108) \
    X(RC_ERR_PHONE_APP_UNAVAILABLE           , -109)

/* Persistent storage and settings errors (-110 to -139). */
#define RC_ERR_STS_STORAGE_LIST(X) \
    X(RC_ERR_STORAGE_FULL                    , -110) \
    X(RC_ERR_STORAGE_NOT_READY               , -111) \
    X(RC_ERR_STORAGE_BUSY                    , -112) \
    X(RC_ERR_READ_FAILED                     , -113) \
    X(RC_ERR_WRITE_FAILED                    , -114) \
    X(RC_ERR_DELETE_FAILED                   , -115) \
    X(RC_ERR_OPEN_FAILED                     , -116) \
    X(RC_ERR_CLOSE_FAILED                    , -117) \
    X(RC_ERR_CREATE_FAILED                   , -118) \
    X(RC_ERR_READ_ONLY                       , -119) \
    X(RC_ERR_END_OF_DATA                     , -120) \
    X(RC_ERR_STORAGE_INIT_FAILED             , -121) \
    X(RC_ERR_STORAGE_MOUNT_FAILED            , -122) \
    X(RC_ERR_STORAGE_FORMAT_FAILED           , -123) \
    X(RC_ERR_STORAGE_RESET_FAILED            , -124) \
    X(RC_ERR_DATA_NOT_FOUND                  , -125) \
    X(RC_ERR_DATA_NOT_AVAILABLE              , -126) \
    X(RC_ERR_DATA_EXPIRED                    , -127) \
    X(RC_ERR_DATA_LOCKED                     , -128) \
    X(RC_ERR_NVM_COMMIT_FAILED               , -129) \
    X(RC_ERR_NVM_ROLLBACK_FAILED             , -130) \
    X(RC_ERR_SETTINGS_INVALID                , -131) \
    X(RC_ERR_SETTINGS_CONFLICT               , -132) \
    X(RC_ERR_SETTINGS_VERSION_MISMATCH       , -133) \
    X(RC_ERR_SETTINGS_RECOVERY_FAILED        , -134) \
    X(RC_ERR_PERSISTENCE_INCOMPLETE          , -135) \
    X(RC_ERR_CREDENTIAL_STORE_FAILED         , -136) \
    X(RC_ERR_CREDENTIAL_LOAD_FAILED          , -137) \
    X(RC_ERR_CREDENTIAL_DELETE_FAILED        , -138) \
    X(RC_ERR_PERSISTENT_ID_MISSING           , -139)

/* Authentication, pairing and cryptography errors (-140 to -169). */
#define RC_ERR_STS_SECURITY_LIST(X) \
    X(RC_ERR_KEY_INVALID                     , -140) \
    X(RC_ERR_KEY_EXPIRED                     , -141) \
    X(RC_ERR_AUTH_TAG_FAILED                 , -142) \
    X(RC_ERR_ENCRYPT_FAILED                  , -143) \
    X(RC_ERR_DECRYPT_FAILED                  , -144) \
    X(RC_ERR_HASH_INVALID                    , -145) \
    X(RC_ERR_SIGNATURE_INVALID               , -146) \
    X(RC_ERR_CERT_INVALID                    , -147) \
    X(RC_ERR_SECURITY_VIOLATION              , -148) \
    X(RC_ERR_SECURITY_LOCKED                 , -149) \
    X(RC_ERR_SECURE_BOOT_FAILED              , -150) \
    X(RC_ERR_AUTHORIZATION_FAILED            , -151) \
    X(RC_ERR_SECURITY_NOT_READY              , -152) \
    X(RC_ERR_SECURITY_NOT_SUPPORTED          , -153) \
    X(RC_ERR_PAIRING_FAILED                  , -154) \
    X(RC_ERR_PAIRING_TIMEOUT                 , -155) \
    X(RC_ERR_PAIR_CODE_INVALID               , -156) \
    X(RC_ERR_PAIR_CODE_EXPIRED               , -157) \
    X(RC_ERR_PAIRING_WINDOW_CLOSED           , -158) \
    X(RC_ERR_BONDING_FAILED                  , -159) \
    X(RC_ERR_BOND_REVOKED                    , -160) \
    X(RC_ERR_SESSION_EXPIRED                 , -161) \
    X(RC_ERR_SESSION_NOT_AUTHENTICATED       , -162) \
    X(RC_ERR_SESSION_ID_MISMATCH             , -163) \
    X(RC_ERR_PERMISSION_REVOKED              , -164) \
    X(RC_ERR_SECURE_STORAGE_UNAVAILABLE      , -165) \
    X(RC_ERR_REPLAY_WINDOW_EXCEEDED          , -166) \
    X(RC_ERR_IDENTITY_NOT_TRUSTED            , -167) \
    X(RC_ERR_HOST_NOT_AUTHENTICATED          , -168) \
    X(RC_ERR_SECURITY_POLICY_DENIED          , -169)

/* RideCast product policy and session errors (-170 to -199). */
#define RC_ERR_STS_RIDECAST_LIST(X) \
    X(RC_ERR_HOST_NOT_SYNCED                 , -170) \
    X(RC_ERR_HOST_UNAVAILABLE                , -171) \
    X(RC_ERR_POLICY_NOT_APPLIED              , -172) \
    X(RC_ERR_OEM_POLICY_LOCKED               , -173) \
    X(RC_ERR_NO_REGISTERED_PHONES            , -174) \
    X(RC_ERR_LAST_PHONE_NOT_SET              , -175) \
    X(RC_ERR_LAST_PHONE_UNAVAILABLE          , -176) \
    X(RC_ERR_PHONE_NOT_ACTIVE                , -177) \
    X(RC_ERR_PHONE_NOT_SELECTED              , -178) \
    X(RC_ERR_PHONE_ALREADY_ACTIVE            , -179) \
    X(RC_ERR_DEVICE_LIMIT_REACHED            , -180) \
    X(RC_ERR_ENROLLMENT_NOT_ALLOWED          , -181) \
    X(RC_ERR_ENROLLMENT_INCOMPLETE           , -182) \
    X(RC_ERR_ENROLLMENT_CANDIDATE_MISSING    , -183) \
    X(RC_ERR_ENROLLMENT_CANDIDATE_REJECTED   , -184) \
    X(RC_ERR_ENROLLMENT_COMMIT_FAILED        , -185) \
    X(RC_ERR_ACTIVE_PHONE_SWITCH_FAILED      , -186) \
    X(RC_ERR_WIRELESS_SESSION_UNAVAILABLE    , -187) \
    X(RC_ERR_CONTENT_NOT_ALLOWED             , -188) \
    X(RC_ERR_CONTENT_CHANNEL_MISMATCH        , -189) \
    X(RC_ERR_CHANNEL_BINDING_MISSING         , -190) \
    X(RC_ERR_CHANNEL_BINDING_MISMATCH        , -191) \
    X(RC_ERR_FEATURE_DISABLED                , -192) \
    X(RC_ERR_FEATURE_UNAVAILABLE             , -193) \
    X(RC_ERR_SHUTDOWN_IN_PROGRESS            , -194) \
    X(RC_ERR_RECONNECT_TIMEOUT               , -195) \
    X(RC_ERR_RECONNECT_DENIED                , -196) \
    X(RC_ERR_REGISTERED_PHONE_REVOKED        , -197) \
    X(RC_ERR_FACTORY_RESET_DENIED            , -198) \
    X(RC_ERR_FIRMWARE_INCOMPATIBLE           , -199)

/* System and platform port errors (-200 to -218). */
#define RC_ERR_STS_SYSTEM_LIST(X) \
    X(RC_ERR_WATCHDOG_FAILURE                , -200) \
    X(RC_ERR_THREAD_CREATE_FAILED            , -201) \
    X(RC_ERR_QUEUE_FULL                      , -202) \
    X(RC_ERR_QUEUE_EMPTY                     , -203) \
    X(RC_ERR_MUTEX_FAILED                    , -204) \
    X(RC_ERR_RESOURCE_LOCKED                 , -205) \
    X(RC_ERR_BOOT_FAILED                     , -206) \
    X(RC_ERR_FIRMWARE_UPDATE_FAILED          , -207) \
    X(RC_ERR_FIRMWARE_ROLLBACK_FAILED        , -208) \
    X(RC_ERR_POWER_STATE_INVALID             , -209) \
    X(RC_ERR_POWER_TRANSITION_FAILED         , -210) \
    X(RC_ERR_LOW_POWER_FAILED                , -211) \
    X(RC_ERR_CLOCK_FAILURE                   , -212) \
    X(RC_ERR_HARDWARE_FAULT                  , -213) \
    X(RC_ERR_DEVICE_NOT_PRESENT              , -214) \
    X(RC_ERR_DEVICE_INIT_FAILED              , -215) \
    X(RC_ERR_DMA_FAILED                      , -216) \
    X(RC_ERR_INTERRUPT_CONFIG_FAILED         , -217) \
    X(RC_ERR_MEMORY_TEST_FAILED              , -218)

/* Unrecoverable internal error (-255). */
#define RC_ERR_STS_FATAL_LIST(X) \
    X(RC_ERR_FATAL                           , -255)


    // clang-format on
/**
 * @brief Master X-macro status list. Use X(name, numeric_value).
 *
 * Example:
 *   #define EMIT_ENUM(name, value) name = value,
 *   enum { RC_ERR_STS_LIST(EMIT_ENUM) };
 *   #undef EMIT_ENUM
 */
#define RC_ERR_STS_LIST(X)      \
    RC_ERR_STS_BASE_LIST(X)     \
    RC_ERR_STS_COMMON_LIST(X)   \
    RC_ERR_STS_COMM_LIST(X)     \
    RC_ERR_STS_NETWORK_LIST(X)  \
    RC_ERR_STS_STORAGE_LIST(X)  \
    RC_ERR_STS_SECURITY_LIST(X) \
    RC_ERR_STS_RIDECAST_LIST(X) \
    RC_ERR_STS_SYSTEM_LIST(X)   \
    RC_ERR_STS_FATAL_LIST(X)

#define RC_ERR_STS_ENUM_ENTRY(name, value) name = value,
    typedef enum rc_err_sts
    {
        RC_ERR_STS_LIST(RC_ERR_STS_ENUM_ENTRY)
    } rc_err_sts_t;
#undef RC_ERR_STS_ENUM_ENTRY

/* Number of defined statuses, NOT an error code or numeric upper bound. */
#define RC_ERR_STS_COUNT_ONE(name, value) +1
    enum
    {
        RC_ERR_STS_COUNT = 0 RC_ERR_STS_LIST(RC_ERR_STS_COUNT_ONE)
    };
#undef RC_ERR_STS_COUNT_ONE

#define RC_IS_SUCCESS(status) ((status) == RC_OK)
#define RC_IS_FAILURE(status) ((status) < RC_OK)

    /**
     * @brief Symbolic status name, such as "RC_ERR_CRC_MISMATCH".
     * @returns "RC_ERR_UNRECOGNIZED" for unknown numeric values.
     * @note Does not allocate memory; returned static string is not to be freed.
     */
    const char* rc_err_sts_to_str(rc_err_sts_t status);

#ifdef __cplusplus
}
#endif

#endif /* RC_ERR_STS_H_ */
```
