## CMakeLists.txt
```
cmake_minimum_required(VERSION 3.20.0)

set(SHIELD ssd1306_128x64)

find_package(Zephyr REQUIRED HINTS $ENV{ZEPHYR_BASE})
project(ridecast_08)

# =========================================================
# Include directories
# =========================================================

target_include_directories(app PRIVATE
    src
    sim
)

# =========================================================
# Common RideCast firmware
# =========================================================

target_sources(app PRIVATE
    src/main.c
    src/heltec_graphic.c
    src/rc_ui_text.c
    src/rc_demo_manager.c
    src/rc_demo_store.c
    src/rc_demo_nav.c
    src/rc_demo_content.c
    src/rc_app_message.c
    src/rc_h7_bridge.c
    src/rc_ble_framing.c
)

# =========================================================
# Simulator configuration from C header
# =========================================================

set(RC_SIM_HEADER
    "${CMAKE_CURRENT_SOURCE_DIR}/sim/rc_app_sim_config.h"
)

set_property(DIRECTORY APPEND PROPERTY
    CMAKE_CONFIGURE_DEPENDS "${RC_SIM_HEADER}"
)

file(STRINGS "${RC_SIM_HEADER}" RC_SIM_LINES
    REGEX "^#define RC_APP_SIM_MODE [012]$"
)

list(LENGTH RC_SIM_LINES RC_SIM_COUNT)

if(NOT RC_SIM_COUNT EQUAL 1)
    message(FATAL_ERROR
        "Define RC_APP_SIM_MODE as 0, 1 or 2 in sim/rc_app_sim_config.h"
    )
endif()

string(REGEX MATCH "RC_APP_SIM_MODE ([012])"
    RC_SIM_MATCH "${RC_SIM_LINES}"
)

set(RC_APP_SIM_MODE "${CMAKE_MATCH_1}")

message(STATUS "RideCast Simulator Mode: ${RC_APP_SIM_MODE}")

# =========================================================
# Radio implementations
# =========================================================

if(RC_APP_SIM_MODE STREQUAL "1")

    # Standalone simulation - no physical radios
    target_sources(app PRIVATE
        sim/rc_app_sim_radio_stubs.c
    )

else()

    # Normal or live simulation - real Wi-Fi
    if(CONFIG_RC_ENABLE_WIFI)
        target_sources(app PRIVATE
            src/rc_connection_ap.c
            src/rc_connection_tcp.c
            src/rc_demo_wifi.c
        )
    endif()

    # Normal or live simulation - real BLE
    if(CONFIG_RC_ENABLE_BLE)
        target_sources(app PRIVATE
            src/rc_demo_ble.c
        )
    endif()

endif()

# =========================================================
# App integration simulator
# =========================================================

if(NOT RC_APP_SIM_MODE STREQUAL "0")
    target_sources(app PRIVATE
        sim/rc_app_simulator.c
        sim/rc_ble_frame_sim.c
    )
endif()
```

## Kconfig
```
mainmenu "RideCast 08: Wi-Fi + BLE"

# =========================================================
# Wi-Fi
# =========================================================

config RC_ENABLE_WIFI
    bool "Enable Wi-Fi AP and TCP"
    depends on WIFI && NETWORKING && NET_SOCKETS
    default y
    help
      Enable RideCast Wi-Fi SoftAP and TCP
      navigation communication.

# =========================================================
# Bluetooth
# =========================================================

config RC_ENABLE_BLE
    bool "Enable BLE pairing and GATT"
    depends on BT && BT_PERIPHERAL && BT_SMP
    default y
    help
      Enable BLE notification and media
      metadata communication.

# =========================================================
# Wi-Fi AP settings
# =========================================================

config RC_WIFI_AP_SSID
    string "RideCast AP SSID"
    default "RideCast-08"

config RC_WIFI_AP_PSK
    string "RideCast development AP password"
    default "RideCast088"
    help
      Development password only.
      Replace for production.

config RC_WIFI_AP_CHANNEL
    int "RideCast AP channel"
    range 1 11
    default 6

# =========================================================
# Zephyr
# =========================================================

source "Kconfig.zephyr"
```

## prj.conf
```kconfig
# =========================================================
# RideCast - ESP32 Heltec WiFi LoRa 32 V2
# =========================================================

# OLED Display
CONFIG_GPIO=y
CONFIG_I2C=y
CONFIG_DISPLAY=y
CONFIG_SSD1306=y
CONFIG_CHARACTER_FRAMEBUFFER=y
CONFIG_CHARACTER_FRAMEBUFFER_USE_DEFAULT_FONTS=y

# Console and logging
CONFIG_CONSOLE=y
CONFIG_PRINTK=y
CONFIG_LOG=y
CONFIG_LOG_DEFAULT_LEVEL=3

# Application resources
CONFIG_MAIN_STACK_SIZE=4096
CONFIG_SYSTEM_WORKQUEUE_STACK_SIZE=3072
CONFIG_HEAP_MEM_POOL_SIZE=32768

# JSON parsing
CONFIG_JSON_LIBRARY=y

# =========================================================
# Wi-Fi Access Point and TCP
# =========================================================

CONFIG_NETWORKING=y
CONFIG_NET_IPV4=y
CONFIG_NET_IPV6=n

CONFIG_WIFI=y
CONFIG_WIFI_NM=y
CONFIG_WIFI_USAGE_MODE_AP=y

CONFIG_NET_SOCKETS=y
CONFIG_NET_TCP=y
CONFIG_NET_UDP=y

CONFIG_NET_CONFIG_AUTO_INIT=n

# DHCP Server
CONFIG_NET_DHCPV4=y
CONFIG_NET_DHCPV4_SERVER=y

CONFIG_NET_IF_MAX_IPV4_COUNT=2

# Network management
CONFIG_NET_MGMT_EVENT=y
CONFIG_NET_MGMT_EVENT_INFO=y
CONFIG_NET_MGMT_EVENT_STACK_SIZE=4096

# Network buffers
CONFIG_NET_PKT_RX_COUNT=16
CONFIG_NET_PKT_TX_COUNT=16
CONFIG_NET_TX_STACK_SIZE=2048
CONFIG_NET_RX_STACK_SIZE=2048

# =========================================================
# BLE
# =========================================================

CONFIG_BT=y
CONFIG_BT_PERIPHERAL=y
CONFIG_BT_SMP=y
CONFIG_BT_SETTINGS=y

CONFIG_BT_DEVICE_NAME="RideCast-08"
CONFIG_BT_MAX_CONN=1

# =========================================================
# Persistent Storage
# =========================================================

CONFIG_FLASH=y
CONFIG_FLASH_MAP=y
CONFIG_NVS=y
CONFIG_SETTINGS=y
CONFIG_SETTINGS_NVS=y

# =========================================================
# RideCast features
# =========================================================

CONFIG_RC_ENABLE_WIFI=y
CONFIG_RC_ENABLE_BLE=y
```

## prj_ble.conf
```kconfig
# Heltec V2 OLED (requires the SSD1306 shield selected in CMakeLists.txt)
CONFIG_GPIO=y
CONFIG_I2C=y
CONFIG_DISPLAY=y
CONFIG_SSD1306=y
CONFIG_CHARACTER_FRAMEBUFFER=y
CONFIG_CHARACTER_FRAMEBUFFER_USE_DEFAULT_FONTS=y
CONFIG_CONSOLE=y
CONFIG_PRINTK=y
CONFIG_LOG=y
CONFIG_LOG_DEFAULT_LEVEL=3
CONFIG_MAIN_STACK_SIZE=4096
CONFIG_SYSTEM_WORKQUEUE_STACK_SIZE=3072
CONFIG_HEAP_MEM_POOL_SIZE=32768
# Networking: ESP32 Wi-Fi STA -> LAN TCP :5050
CONFIG_NETWORKING=y
CONFIG_NET_IPV4=y
CONFIG_NET_IPV6=n
CONFIG_NET_MGMT_EVENT=y
# Bluetooth LE peripheral: native bonding/passkey via mobile OS
CONFIG_BT=y
CONFIG_BT_PERIPHERAL=y
CONFIG_BT_SMP=y
CONFIG_BT_SETTINGS=y
CONFIG_BT_DEVICE_NAME="RideCast-08"
CONFIG_BT_MAX_CONN=1
# Persistent storage for BLE bonds + one development Wi-Fi client token
CONFIG_FLASH=y
CONFIG_FLASH_MAP=y
CONFIG_NVS=y
CONFIG_SETTINGS=y
CONFIG_SETTINGS_NVS=y
# RideCast demo switches
CONFIG_RC_ENABLE_BLE=y
CONFIG_RC_ENABLE_WIFI=n
```

## prj_wifi.conf
```kconfig
# Heltec V2 OLED (requires the SSD1306 shield selected in CMakeLists.txt)
CONFIG_GPIO=y
CONFIG_I2C=y
CONFIG_DISPLAY=y
CONFIG_SSD1306=y
CONFIG_CHARACTER_FRAMEBUFFER=y
CONFIG_CHARACTER_FRAMEBUFFER_USE_DEFAULT_FONTS=y
CONFIG_CONSOLE=y
CONFIG_PRINTK=y
CONFIG_LOG=y
CONFIG_LOG_DEFAULT_LEVEL=3
CONFIG_MAIN_STACK_SIZE=4096
CONFIG_SYSTEM_WORKQUEUE_STACK_SIZE=3072
CONFIG_HEAP_MEM_POOL_SIZE=32768
# Networking: ESP32 Wi-Fi AP -> direct phone TCP :5050
CONFIG_NETWORKING=y
CONFIG_NET_IPV4=y
CONFIG_NET_IPV6=n
CONFIG_WIFI=y
CONFIG_NET_SOCKETS=y
CONFIG_NET_TCP=y
CONFIG_NET_UDP=y
CONFIG_WIFI_NM=y
CONFIG_WIFI_USAGE_MODE_AP=y
CONFIG_NET_CONFIG_AUTO_INIT=n
CONFIG_NET_DHCPV4=y
CONFIG_NET_DHCPV4_SERVER=y
CONFIG_NET_IF_MAX_IPV4_COUNT=2
CONFIG_NET_MGMT_EVENT_INFO=y
CONFIG_NET_MGMT_EVENT_STACK_SIZE=4096
CONFIG_NET_PKT_RX_COUNT=16
CONFIG_NET_PKT_TX_COUNT=16
CONFIG_NET_MGMT_EVENT=y
CONFIG_NET_TX_STACK_SIZE=2048
CONFIG_NET_RX_STACK_SIZE=2048
# Bluetooth LE peripheral: native bonding/passkey via mobile OS
# Persistent storage for BLE bonds + one development Wi-Fi client token
CONFIG_FLASH=y
CONFIG_FLASH_MAP=y
CONFIG_NVS=y
CONFIG_SETTINGS=y
CONFIG_SETTINGS_NVS=y
# RideCast demo switches
CONFIG_RC_ENABLE_WIFI=y
CONFIG_RC_ENABLE_BLE=n
```

## app.overlay
```dts
/*
 * RideCast - Heltec WiFi LoRa 32 V2
 * SSD1306 128x64 OLED
 */

#include <zephyr/dt-bindings/i2c/i2c.h>

/* I2C bus */
&i2c0 {
    status = "okay";
    clock-frequency = <I2C_BITRATE_STANDARD>;
};

/* SSD1306 OLED */
&ssd1306_ssd1306_128x64 {
    status = "okay";
    zephyr,deferred-init;
};
```

## src/main.c
```c
/* 08_ridecast: first dual-radio enrollment/connection demo (Zephyr + Heltec
 * V2). Wi-Fi: broadcast WPA2 RideCast AP, receive OTP/saved token on TCP :5050.
 * BLE: advertise, phone OS enters native pairing passkey, bond persists.
 * Two independent authorized content sessions can run together.
 */
#include <zephyr/kernel.h>
#include <zephyr/sys/printk.h>
#include "rc_demo_manager.h"
#include "rc_demo_store.h"
#include "heltec_graphic.h"
#include "rc_demo_nav.h"
#include "rc_demo_content.h"
#include "rc_h7_bridge.h"
#ifdef CONFIG_RC_ENABLE_WIFI
    #include "rc_demo_wifi.h"
#endif
#ifdef CONFIG_RC_ENABLE_BLE
    #include "rc_demo_ble.h"
#endif

int main(void)
{
    rc_err_sts_t r = heltec_graphic_init();
    if(r != RC_OK)
    {
        printk("RideCast OLED init failed: %d\n", (int)r);
        return 0;
    }
    r = rc_demo_store_init();
    if(r != RC_OK)
    {
        printk("RideCast flash settings unavailable: %d\n", (int)r);
        /* Fail closed: show failure instead of starting unaudited pairing. */
        rc_demo_snapshot_t failed = { .stage = RC_DEMO_FAILED, .error = RC_ERR_STORAGE };
        while(true)
        {
            (void)heltec_graphic_render_connection(&failed);
            k_sleep(K_SECONDS(1));
        }
    }
    rc_demo_manager_init(rc_demo_store_has_wifi_token());
    rc_h7_bridge_init();
    printk("RideCast 08: starting radios (WIFI=%d BLE=%d)\n",
           IS_ENABLED(CONFIG_RC_ENABLE_WIFI), IS_ENABLED(CONFIG_RC_ENABLE_BLE));

#ifdef CONFIG_RC_ENABLE_BLE
    r = rc_demo_ble_start();
    if(r != RC_OK)
    {
        printk("RideCast BLE start error: %d\n", (int)r);
        rc_demo_manager_radio_failure(RC_DEMO_LINK_BLE, r);
    }
#endif
#ifdef CONFIG_RC_ENABLE_WIFI
    r = rc_demo_wifi_start();
    if(r != RC_OK)
    {
        printk("RideCast Wi-Fi start error: %d\n", (int)r);
        rc_demo_manager_radio_failure(RC_DEMO_LINK_WIFI, r);
    }
#endif

    while(true)
    {
        rc_h7_bridge_pump(); /* simulated ESP32 -> H7 -> OLED data path */
        rc_demo_snapshot_t now = rc_demo_manager_get();
        heltec_nav_screen_t nav;
        const bool nav_active = now.wifi_authenticated && rc_demo_nav_latest(&nav);
        rc_demo_content_t content;
        /* Never obscure a six-digit pairing code with incoming content. */
        if(now.pin_visible || now.stage == RC_DEMO_WIFI_TOKEN || now.stage == RC_DEMO_FAILED)
        {
            r = heltec_graphic_render_connection(&now);
        }
        else if(now.ble_authenticated && rc_demo_content_latest(&content, nav_active))
        {
            r = heltec_graphic_render_content(&content);
        }
        else if(nav_active)
        {
            r = heltec_graphic_render(&nav);
        }
        else
        {
            r = heltec_graphic_render_connection(&now);
        }
        if(RC_IS_FAILURE(r))
        {
            printk("RideCast OLED render failed: %d, %s\n", (int)r, rc_err_sts_to_str(r));
        }
        else if(r != RC_OK)
        {
            printk("RideCast OLED invalid positive status: %d\n", (int)r);
        }
        k_msleep(250);
    }
}
```

## src/heltec_graphic.c
```c
/* SPDX-License-Identifier: MIT
 * Monochrome RideCast screen for the Heltec V2 128x64 SSD1306.
 * Tested initialization sequence taken from the project's prior OLED samples:
 * I2C recovery -> deferred device_init -> CFB -> display unblank.
 */
#include "heltec_graphic.h"
#include "rc_ui_text.h"

#include <zephyr/kernel.h>
#include <zephyr/device.h>
#include <zephyr/devicetree.h>
#include <zephyr/drivers/display.h>
#include <zephyr/drivers/i2c.h>
#include <zephyr/display/cfb.h>
#include <zephyr/sys/printk.h>
#include <errno.h>
#include <stdbool.h>
#include <stddef.h>
#include <stdint.h>
#include <stdio.h>
#include <string.h>

#define RC_OLED_W    128
#define RC_OLED_H    64
/* SSD1306 has 128 real columns. Use safe 4px side and 2px bottom margins. */
#define RC_UI_LEFT   4
#define RC_UI_RIGHT  123 /* inclusive */
#define RC_UI_BOTTOM 61  /* inclusive */
#define RC_I2C_NODE  DT_NODELABEL(i2c0)

#if !DT_HAS_CHOSEN(zephyr_display)
    #error "Select shield ssd1306_128x64 (zephyr,display missing)"
#endif
#define RC_OLED_NODE DT_CHOSEN(zephyr_display)
#if !DT_NODE_HAS_STATUS(RC_I2C_NODE, okay)
    #error "Heltec I2C0 must be enabled in app.overlay"
#endif
#if !DT_NODE_HAS_STATUS(RC_OLED_NODE, okay)
    #error "SSD1306 must be enabled in app.overlay"
#endif
#if !DT_PROP(RC_OLED_NODE, zephyr_deferred_init)
    #error "SSD1306 needs zephyr,deferred-init in app.overlay"
#endif

static const struct device* const i2c_dev  = DEVICE_DT_GET(RC_I2C_NODE);
static const struct device* const oled_dev = DEVICE_DT_GET(RC_OLED_NODE);
static bool initialized;
static uint8_t font_width  = 8;
static uint8_t font_height = 8;

#define DRAW_CHECK(expression)  \
    do                          \
    {                           \
        int _rc = (expression); \
        if(_rc < 0)             \
            return _rc;         \
    } while(0)


static rc_err_sts_t rc_display_from_zephyr(int result)
{
    if(result == 0)
    {
        return RC_OK;
    }

    /* Only use for Zephyr APIs documented
     * to return zero or negative errno.
     */
    if(result > 0)
    {
        return RC_ERR_DISPLAY_UNEXPECTED_RETURN;
    }

    switch(-result)
    {
        case ENODEV:
            return RC_ERR_DISPLAY_NOT_READY;

        case EINVAL:
            return RC_ERR_INVALID_ARG;

        case ENOTSUP:
        case ENOSYS:
            return RC_ERR_DISPLAY_UNSUPPORTED_OPERATION;

        case ENOMEM:
            return RC_ERR_DISPLAY_MEMORY_EXHAUSTED;

        case EAGAIN:
        case EBUSY:
            return RC_ERR_DISPLAY_BUSY;

        case ETIMEDOUT:
            return RC_ERR_DISPLAY_TIMEOUT;

        case ERANGE:
            return RC_ERR_DISPLAY_OUT_OF_BOUNDS;

        case EIO:
            return RC_ERR_IO;

        default:
            return RC_ERR_DISPLAY_RENDER_FAILED;
    }
}


static int draw_line(int x0, int y0, int x1, int y1)
{
    const struct cfb_position a = { (int16_t)x0, (int16_t)y0 };
    const struct cfb_position b = { (int16_t)x1, (int16_t)y1 };
    return cfb_draw_line(oled_dev, &a, &b);
}

/* Generic pixel-span adapter for the compact 5x7 text renderer. */
static int draw_span(void* ctx, int x0, int y, int x1)
{
    (void)ctx;
    return draw_line(x0, y, x1, y);
}

static int draw_small_text(const char* s, int left, int right, int y, rc_ui_align_t align)
{
    return rc_ui_compact_draw(s, left, right, y, RC_UI_BOTTOM, align, draw_span, NULL);
}

/* Fit each row before drawing. Full-size Zephyr CFB first; compact 5x7
 * automatically if the CFB font would overflow, then ellipsis as a last
 * resort. This prevents the driver's automatic line wrapping/overlap. */
static int draw_fit_text(const char* s, int left, int right, int y, rc_ui_align_t align, bool prefer_large)
{
    if(s == NULL || left < 0 || right > RC_UI_RIGHT || right < left || y < 0)
    {
        return -EINVAL;
    }
    int available = right - left + 1;
    size_t n      = strlen(s);
    if(prefer_large && font_width > 0U && font_height > 0U &&
       font_height <= 8U && /* never overlap the next independent row */
       y + font_height - 1U <= RC_UI_BOTTOM && n <= (size_t)(available / font_width))
    {
        int width = (int)(n * font_width);
        int x     = rc_ui_text_origin(left, right, width, align);
        return cfb_print(oled_dev, s, (int16_t)x, (int16_t)y);
    }
    return draw_small_text(s, left, right, y, align);
}

/* UI bands are bounded and never overlap:
 *   header RC + broadcast indicator : y=2..12
 *   connection title                 : y=14..21
 *   connection primary message       : y=26..33
 *   connection instruction           : y=39..46
 *   connection radio/status footer   : y=54..61
 * Navigation uses its own centered arrow/distance row.
 */

/* 3x5 micro-font used ONLY for the tiny top-left/right status labels.
 * Other labels automatically fit using CFB or the 5x7 compact font.
 * Each row is a 3-bit mask (bit 2 is leftmost pixel).
 */
static const uint8_t* micro_glyph(char ch)
{
    static const uint8_t glyph_r[5]     = { 6, 5, 6, 5, 5 };
    static const uint8_t glyph_c[5]     = { 3, 4, 4, 4, 3 };
    static const uint8_t glyph_s[5]     = { 3, 4, 2, 1, 6 };
    static const uint8_t glyph_i[5]     = { 7, 2, 2, 2, 7 };
    static const uint8_t glyph_m[5]     = { 5, 7, 7, 5, 5 };
    static const uint8_t glyph_o[5]     = { 2, 5, 5, 5, 2 };
    static const uint8_t glyph_f[5]     = { 7, 4, 6, 4, 4 };
    static const uint8_t glyph_w[5]     = { 5, 5, 7, 7, 5 };
    static const uint8_t glyph_n[5]     = { 5, 7, 7, 7, 5 };
    static const uint8_t glyph_l[5]     = { 4, 4, 4, 4, 7 };
    static const uint8_t glyph_e[5]     = { 7, 4, 6, 4, 7 };
    static const uint8_t glyph_g[5]     = { 3, 4, 5, 5, 3 };
    static const uint8_t glyph_p[5]     = { 6, 5, 6, 4, 4 };
    static const uint8_t glyph_colon[5] = { 0, 2, 0, 2, 0 };
    switch(ch)
    {
        case 'R':
            return glyph_r;
        case 'C':
            return glyph_c;
        case 'S':
            return glyph_s;
        case 'I':
            return glyph_i;
        case 'M':
            return glyph_m;
        case 'O':
            return glyph_o;
        case 'F':
            return glyph_f;
        case 'W':
            return glyph_w;
        case 'N':
            return glyph_n;
        case 'L':
            return glyph_l;
        case 'E':
            return glyph_e;
        case 'G':
            return glyph_g;
        case 'P':
            return glyph_p;
        case ':':
            return glyph_colon;
        default:
            return NULL;
    }
}

static int draw_micro_text(const char* text, int x, int y)
{
    if(text == NULL || x < 0 || y < 0)
    {
        return -EINVAL;
    }
    size_t count = strlen(text);
    /* each glyph is 3 wide; inter-character gap is 1 pixel */
    if(count == 0U || count > 16U ||
       x + (int)(count * 4U - 1U) - 1 > RC_UI_RIGHT || y + 4 > RC_UI_BOTTOM)
    {
        return -EINVAL;
    }
    for(size_t i = 0U; i < count; ++i)
    {
        const uint8_t* g = micro_glyph(text[i]);
        if(g == NULL)
        {
            return -EINVAL;
        }
        const int gx = x + (int)(i * 4U);
        for(int row = 0; row < 5; ++row)
        {
            for(int col = 0; col < 3; ++col)
            {
                if((g[row] & (uint8_t)(4U >> col)) != 0U)
                {
                    DRAW_CHECK(draw_line(gx + col, y + row, gx + col, y + row));
                }
            }
        }
    }
    return 0;
}

static int segment(int x0, int y0, uint8_t which)
{
    switch(which)
    {
        case 0:
            return draw_line(x0 + 2, y0, x0 + 9, y0);           /* top */
        case 1:
            return draw_line(x0 + 10, y0 + 1, x0 + 10, y0 + 8); /* top right */
        case 2:
            return draw_line(x0 + 10, y0 + 10, x0 + 10, y0 + 17); /* bottom right */
        case 3:
            return draw_line(x0 + 2, y0 + 18, x0 + 9, y0 + 18); /* bottom */
        case 4:
            return draw_line(x0 + 1, y0 + 10, x0 + 1, y0 + 17); /* bottom left */
        case 5:
            return draw_line(x0 + 1, y0 + 1, x0 + 1, y0 + 8);   /* top left */
        case 6:
            return draw_line(x0 + 2, y0 + 9, x0 + 9, y0 + 9);   /* middle */
        default:
            return -EINVAL;
    }
}

static int big_digit(uint8_t digit, int x, int y)
{
    static const uint8_t bitmap[] = {
        0x3f, /* 0: A B C D E F */
        0x06, /* 1: B C */
        0x5b, /* 2: A B D E G */
        0x4f, /* 3: A B C D G */
        0x66, /* 4: B C F G */
        0x6d, /* 5: A C D F G */
        0x7d, /* 6: A C D E F G */
        0x07, /* 7: A B C */
        0x7f, /* 8: all */
        0x6f  /* 9: A B C D F G */
    };
    if(digit > 9U)
    {
        return -EINVAL;
    }
    for(uint8_t seg = 0; seg < 7U; ++seg)
    {
        if((bitmap[digit] & (1U << seg)) != 0U)
        {
            DRAW_CHECK(segment(x, y, seg));
        }
    }
    return 0;
}

static int draw_distance(uint16_t meters)
{
    if(meters > 999U)
    {
        meters = 999U; /* display limit; underlying model is unchanged */
    }

    /* Center number AND unit within x=50..123, regardless of digit count. */
    const int digits      = (meters >= 100U) ? 3 : (meters >= 10U ? 2 : 1);
    const int unit_width  = 5; /* compact lower-case m */
    const int total_width = (digits - 1) * 14 + 11 + 3 + unit_width;
    int x = rc_ui_text_origin(50, RC_UI_RIGHT, total_width, RC_UI_ALIGN_CENTER);
    if(meters >= 100U)
    {
        DRAW_CHECK(big_digit((uint8_t)(meters / 100U), x, 16));
        x += 14;
    }
    if(meters >= 10U)
    {
        DRAW_CHECK(big_digit((uint8_t)((meters / 10U) % 10U), x, 16));
        x += 14;
    }
    DRAW_CHECK(big_digit((uint8_t)(meters % 10U), x, 16));
    x += 14;
    return draw_small_text("m", x, RC_UI_RIGHT, 22, RC_UI_ALIGN_LEFT);
}

static int draw_turn_icon(heltec_turn_t turn)
{
    switch(turn)
    {
        case HELTEC_TURN_RIGHT:
            DRAW_CHECK(draw_line(12, 36, 12, 26));
            DRAW_CHECK(draw_line(12, 26, 35, 26));
            DRAW_CHECK(draw_line(35, 26, 27, 18));
            return draw_line(35, 26, 27, 34);
        case HELTEC_TURN_LEFT:
            DRAW_CHECK(draw_line(35, 36, 35, 26));
            DRAW_CHECK(draw_line(35, 26, 12, 26));
            DRAW_CHECK(draw_line(12, 26, 20, 18));
            return draw_line(12, 26, 20, 34);
        case HELTEC_TURN_STRAIGHT:
            DRAW_CHECK(draw_line(24, 36, 24, 17));
            DRAW_CHECK(draw_line(24, 17, 16, 25));
            return draw_line(24, 17, 32, 25);
        case HELTEC_TURN_ARRIVED:
            DRAW_CHECK(draw_line(12, 27, 20, 36));
            return draw_line(20, 36, 37, 17);
        case HELTEC_TURN_NONE:
            DRAW_CHECK(draw_line(18, 20, 29, 20));
            DRAW_CHECK(draw_line(29, 20, 29, 28));
            return draw_line(24, 33, 24, 35);
        default:
            return -EINVAL;
    }
}

static void select_compact_font(void)
{
    int best       = -1;
    uint8_t best_w = 255U;
    uint8_t best_h = 255U;
    int font_count = cfb_get_numof_fonts(oled_dev);
    for(int i = 0; i < font_count; ++i)
    {
        uint8_t w = 0U;
        uint8_t h = 0U;
        if(cfb_get_font_size(oled_dev, (uint8_t)i, &w, &h) == 0 && w > 0U &&
           h > 0U && (best < 0 || w < best_w || (w == best_w && h < best_h)))
        {
            best   = i;
            best_w = w;
            best_h = h;
        }
    }
    if(best >= 0 && cfb_framebuffer_set_font(oled_dev, (uint8_t)best) == 0)
    {
        font_width  = best_w;
        font_height = best_h;
    }
    printk("RideCast OLED CFB font %ux%u (5x7 auto-fit fallback)\n", font_width, font_height);
}

rc_err_sts_t heltec_graphic_init(void)
{
    if(initialized)
    {
        return RC_ERR_ALREADY_INITIALIZED;
    }
    if(!device_is_ready(i2c_dev))
    {
        return RC_ERR_NOT_READY;
    }
    int status = i2c_recover_bus(i2c_dev);
    if(status < 0)
    {
        printk("OLED I2C recovery failed: %d\n", status);
        return RC_ERR_IO;
    }
    status = device_init(oled_dev);
    if(status < 0 || !device_is_ready(oled_dev))
    {
        printk("OLED device initialization failed: %d\n", status);
        return RC_ERR_INIT_FAILED;
    }
    status = display_set_pixel_format(oled_dev, PIXEL_FORMAT_MONO01);
    if(status < 0)
    {
        return RC_ERR_NOT_SUPPORTED;
    }
    status = cfb_framebuffer_init(oled_dev);
    if(status < 0)
    {
        return RC_ERR_INIT_FAILED;
    }
    select_compact_font();
    status = cfb_framebuffer_clear(oled_dev, false);
    if(status < 0 || display_blanking_off(oled_dev) < 0)
    {
        return RC_ERR_IO;
    }
    initialized = true;
    return RC_OK;
}

rc_err_sts_t heltec_graphic_render(const heltec_nav_screen_t* screen)
{
    if(!initialized)
    {
        return RC_ERR_NOT_INITIALIZED;
    }
    if(screen == NULL || screen->turn > HELTEC_TURN_ARRIVED ||
       screen->link > HELTEC_LINK_ONLINE || screen->speed_kmh > 240U)
    {
        return RC_ERR_INVALID_ARG;
    }
    const char* link_label;
    switch(screen->link)
    {
        case HELTEC_LINK_DEMO:
            link_label = "SIM";
            break;
        case HELTEC_LINK_OFFLINE:
            link_label = "OFF";
            break;
        case HELTEC_LINK_WIFI:
            link_label = "WIFI";
            break;
        case HELTEC_LINK_ONLINE:
            link_label = "ONLINE";
            break;
        default:
            return RC_ERR_INVALID_ARG;
    }
    const char* turn_label;
    switch(screen->turn)
    {
        case HELTEC_TURN_RIGHT:
            turn_label = "TURN RIGHT";
            break;
        case HELTEC_TURN_LEFT:
            turn_label = "TURN LEFT";
            break;
        case HELTEC_TURN_STRAIGHT:
            turn_label = "STRAIGHT";
            break;
        case HELTEC_TURN_ARRIVED:
            turn_label = "ARRIVED";
            break;
        case HELTEC_TURN_NONE:
            turn_label = "WAIT NAV";
            break;
        default:
            return RC_ERR_INVALID_ARG;
    }
    char speed[20];
    char gps[12];
    (void)snprintf(speed, sizeof(speed), "%ukm/h", (unsigned int)screen->speed_kmh);
    (void)snprintf(gps, sizeof(gps), "GPS: %s", screen->gps_valid ? "OK" : "NO");

    const int link_x = RC_UI_RIGHT - (int)(4U * strlen(link_label) - 1U) + 1;
    int status       = cfb_framebuffer_clear(oled_dev, false);
    if(status >= 0)
        status = draw_micro_text("RC", RC_UI_LEFT, 3);
    if(status >= 0)
        status = draw_micro_text(link_label, link_x, 3);
    if(status >= 0)
        status = draw_turn_icon(screen->turn);
    if(status >= 0)
        status = draw_distance(screen->distance_m);
    if(status >= 0)
        status = draw_fit_text(turn_label, RC_UI_LEFT, RC_UI_RIGHT, 40,
                               RC_UI_ALIGN_CENTER, true);
    /* Two fixed lanes guarantee max speed and GPS labels never collide. */
    if(status >= 0)
        status = draw_fit_text(speed, 4, 64, 53, RC_UI_ALIGN_LEFT, true);
    if(status >= 0)
        status = draw_small_text(gps, 78, RC_UI_RIGHT, 54, RC_UI_ALIGN_RIGHT);
    if(status >= 0)
        status = cfb_framebuffer_finalize(oled_dev);
    return status < 0 ? RC_ERR_IO : RC_OK;
}

/* Show short BLE notification/music metadata using measured, clipped rows.
 * Full text belongs on the future STM32H7 color display. */
rc_err_sts_t heltec_graphic_render_content(const rc_demo_content_t* item)
{
    if(!initialized)
        return RC_ERR_NOT_INITIALIZED;
    if(!item || (item->kind != RC_CONTENT_NOTIFICATION && item->kind != RC_CONTENT_MUSIC))
        return RC_ERR_INVALID_ARG;
    const char* title = item->kind == RC_CONTENT_MUSIC ? "MUSIC" : "NOTIFICATION";
    int r = cfb_framebuffer_clear(oled_dev, false);
    if(r >= 0)
        r = draw_micro_text("RC", RC_UI_LEFT, 3);
    if(r >= 0)
        r = draw_small_text(title, RC_UI_LEFT, RC_UI_RIGHT, 13, RC_UI_ALIGN_CENTER);
    if(r >= 0)
        r = draw_fit_text(item->source, RC_UI_LEFT, RC_UI_RIGHT, 25,
                          RC_UI_ALIGN_CENTER, true);
    if(r >= 0)
        r = draw_small_text(item->sender, RC_UI_LEFT, RC_UI_RIGHT, 39, RC_UI_ALIGN_CENTER);
    if(r >= 0)
        r = draw_small_text(item->text, RC_UI_LEFT, RC_UI_RIGHT, 53, RC_UI_ALIGN_CENTER);
    if(r >= 0)
        r = cfb_framebuffer_finalize(oled_dev);
    return r < 0 ? RC_ERR_IO : RC_OK;
}

/* A tiny 12x12 animated broadcast badge in the top-right HEADER.
 * Unlike the old graphic, it never shares a row with the AP address.
 */
static int draw_wifi_broadcast(uint8_t frame)
{
    /* Pixel-dot and expanding strokes, all inside x=113..123, y=2..11. */
    DRAW_CHECK(draw_line(118, 10, 119, 10));
    if(frame == 1U || frame == 2U || frame == 3U)
    {
        DRAW_CHECK(draw_line(116, 7, 118, 5));
        DRAW_CHECK(draw_line(119, 5, 121, 7));
    }
    if(frame == 2U || frame == 3U)
    {
        DRAW_CHECK(draw_line(113, 5, 116, 2));
        DRAW_CHECK(draw_line(120, 2, 123, 5));
    }
    return 0;
}

rc_err_sts_t heltec_graphic_render_connection(const rc_demo_snapshot_t* s)
{
    rc_err_sts_t ret = RC_OK;
    if(!initialized)
        return RC_ERR_NOT_INITIALIZED;
    if(s == NULL)
        return RC_ERR_INVALID_ARG;
    const bool broadcast      = s->stage == RC_DEMO_WAIT && s->wifi_ready;
    const uint8_t pulse_frame = (uint8_t)((k_uptime_get_32() / 250U) % 4U);
    const char* title         = "WAIT APP";
    const char* main_line     = "WIFI + BLE";
    const char* detail        = "READY";
    char pin_line[24]         = "";
    char footer[20];
    const char* radio = "NONE";
    if(s->wifi_authenticated && s->ble_authenticated)
        radio = "WIFI+BLE";
    else if(s->wifi_authenticated)
        radio = "WIFI";
    else if(s->ble_authenticated)
        radio = "BLE";
    switch(s->stage)
    {
        case RC_DEMO_WIFI_ENROLL:
            title     = "WIFI PAIR";
            detail    = "ENTER IN APP";
            main_line = "6 DIGIT CODE";
            break;
        case RC_DEMO_WIFI_TOKEN:
            title     = "WIFI AUTH";
            main_line = "SAVED TOKEN";
            detail    = "WAIT APP";
            break;
        case RC_DEMO_BLE_PAIR:
            title     = "BLE PAIR";
            main_line = "PHONE: PAIR";
            detail    = "ENTER PIN";
            break;
        case RC_DEMO_ACTIVE:
            title     = "CONN OK";
            main_line = radio;
            detail    = "AUTH SAVED";
            break;
        case RC_DEMO_FAILED:
            title     = "CONN FAIL";
            main_line = "CHECK CODE";
            detail    = "TRY RECONNECT";
            break;
        case RC_DEMO_WAIT:
        default:
            if(s->wifi_ready)
            {
                title     = "WIFI READY";
                main_line = "192.168.4.1";
                detail    = s->wifi_stations > 0 ? "OPEN APP" : "JOIN RIDECAST";
            }
            break;
    }
    /* Surface radio init/AP failures even if the other radio still works. */
    if(s->stage == RC_DEMO_WAIT && !s->wifi_ready && !s->ble_ready &&
       (s->wifi_radio_error != RC_OK || s->ble_radio_error != RC_OK))
    {
        title     = "RADIO FAIL";
        main_line = s->wifi_radio_error != RC_OK ? "WIFI ERROR" : "BLE ERROR";
        detail    = "CHECK LOGS";
    }
    if(s->pin_visible)
    {
        (void)snprintf(pin_line, sizeof(pin_line), "PIN: %06u", (unsigned)s->pin);
        main_line = pin_line;
    }
    /* A station can be associated without a TCP/application connection.
     * The WAIT screen still shows the AP broadcast animation after TCP close. */
    (void)snprintf(footer, sizeof(footer), "W:%s B:%s S:%u",
                   s->wifi_radio_error != RC_OK ? "ER" : (s->wifi_ready ? "ON" : "--"),
                   s->ble_radio_error != RC_OK ? "ER" : (s->ble_ready ? "ON" : "--"),
                   (unsigned)s->wifi_stations);
    int r = cfb_framebuffer_clear(oled_dev, false);
    /* Strict row bands and centered text remove clipping on actual SSD1306. */
    if(r >= 0)
        r = draw_micro_text("RC", RC_UI_LEFT, 3);
    if(r >= 0 && broadcast)
        r = draw_wifi_broadcast(pulse_frame);
    if(r >= 0)
        r = draw_small_text(title, RC_UI_LEFT, RC_UI_RIGHT, 14, RC_UI_ALIGN_CENTER);
    if(r >= 0)
        r = draw_fit_text(main_line, RC_UI_LEFT, RC_UI_RIGHT, 26, RC_UI_ALIGN_CENTER, true);
    if(r >= 0)
        r = draw_small_text(detail, RC_UI_LEFT, RC_UI_RIGHT, 39, RC_UI_ALIGN_CENTER);
    if(r >= 0)
        r = draw_small_text(footer, RC_UI_LEFT, RC_UI_RIGHT, 54, RC_UI_ALIGN_CENTER);
    if(r >= 0)
        r = cfb_framebuffer_finalize(oled_dev);

    return rc_display_from_zephyr(r);
}
```

## src/heltec_graphic.h
```c
/* SPDX-License-Identifier: MIT
 * RideCast Heltec 128x64 OLED navigation UI (Zephyr CFB / SSD1306).
 * Graphics layer only: no Wi-Fi, TCP, phone, or RideCast protocol dependency.
 */
#ifndef HELTEC_GRAPHIC_H_
#define HELTEC_GRAPHIC_H_

#include <stdbool.h>
#include <stdint.h>
#include "rc_err_sts.h"
#include "rc_demo_manager.h"
#include "rc_demo_content.h"

#ifdef __cplusplus
extern "C" {
#endif

typedef enum {
    HELTEC_TURN_NONE = 0,
    HELTEC_TURN_STRAIGHT,
    HELTEC_TURN_LEFT,
    HELTEC_TURN_RIGHT,
    HELTEC_TURN_ARRIVED
} heltec_turn_t;

typedef enum {
    HELTEC_LINK_DEMO = 0, /* No radio connection: locally generated samples */
    HELTEC_LINK_OFFLINE,  /* Wi-Fi unavailable */
    HELTEC_LINK_WIFI,     /* AP enabled, no TCP peer */
    HELTEC_LINK_ONLINE    /* AP + authorized TCP navigation session */
} heltec_link_t;

typedef struct {
    heltec_turn_t turn;
    heltec_link_t link;
    uint16_t distance_m;    /* On-screen distance is capped at 999 m */
    uint16_t speed_kmh;     /* 0...240 */
    bool gps_valid;
} heltec_nav_screen_t;

/* Must be called once, from thread context, before render(). */
rc_err_sts_t heltec_graphic_init(void);

/* Only the application/UI thread may call this function.
 * Uses a full back-buffer and one finalize() per frame.
 * v0.6: auto-fit, centered labels, compact footer: speed | GPS: OK/NO.
 */
rc_err_sts_t heltec_graphic_render(const heltec_nav_screen_t *screen);

/* 128x64 concise enrollment and connection result screen.
 * Must be rendered from the single application UI thread only. */
rc_err_sts_t heltec_graphic_render_content(const rc_demo_content_t *content);
rc_err_sts_t heltec_graphic_render_connection(const rc_demo_snapshot_t *state);

#ifdef __cplusplus
}
#endif
#endif /* HELTEC_GRAPHIC_H_ */
```

## src/rc_app_message.c
```c
/* JSON to transport-independent RideCast v1 data model.
 * Uses Zephyr's bounded JSON lexer; it intentionally does not allocate heap.
 */
#include "rc_app_message.h"
#include "rc_h7_bridge.h"
#include "ridecast_config.h"
#include <zephyr/data/json.h>
#include <zephyr/sys/util.h>
#include <errno.h>
#include <stddef.h>
#include <string.h>

struct wire_gps {
    int32_t valid;
    int32_t lat_e7;
    int32_t lon_e7;
};

/* Numeric fields default to -1 when absent, so required fields can be tested.
 * GPS fields are nested in the JSON object, matching the phone-side contract. */
struct wire_msg {
    int32_t v, seq, distance_m, speed_kmh, remaining_m, eta_sec;
    int32_t position_ms, duration_ms;
    const char *type, *maneuver, *road, *app, *sender, *title, *text;
    const char *artist, *album, *state;
    struct wire_gps gps;
};

static const struct json_obj_descr gps_desc[] = {
    JSON_OBJ_DESCR_PRIM(struct wire_gps, valid, JSON_TOK_NUMBER),
    JSON_OBJ_DESCR_PRIM(struct wire_gps, lat_e7, JSON_TOK_NUMBER),
    JSON_OBJ_DESCR_PRIM(struct wire_gps, lon_e7, JSON_TOK_NUMBER),
};
static const struct json_obj_descr msg_desc[] = {
    JSON_OBJ_DESCR_PRIM(struct wire_msg, v, JSON_TOK_NUMBER),
    JSON_OBJ_DESCR_PRIM(struct wire_msg, seq, JSON_TOK_NUMBER),
    JSON_OBJ_DESCR_PRIM(struct wire_msg, type, JSON_TOK_STRING),
    JSON_OBJ_DESCR_PRIM(struct wire_msg, maneuver, JSON_TOK_STRING),
    JSON_OBJ_DESCR_PRIM(struct wire_msg, distance_m, JSON_TOK_NUMBER),
    JSON_OBJ_DESCR_PRIM(struct wire_msg, speed_kmh, JSON_TOK_NUMBER),
    JSON_OBJ_DESCR_PRIM(struct wire_msg, remaining_m, JSON_TOK_NUMBER),
    JSON_OBJ_DESCR_PRIM(struct wire_msg, eta_sec, JSON_TOK_NUMBER),
    JSON_OBJ_DESCR_PRIM(struct wire_msg, road, JSON_TOK_STRING),
    JSON_OBJ_DESCR_OBJECT(struct wire_msg, gps, gps_desc),
    JSON_OBJ_DESCR_PRIM(struct wire_msg, app, JSON_TOK_STRING),
    JSON_OBJ_DESCR_PRIM(struct wire_msg, sender, JSON_TOK_STRING),
    JSON_OBJ_DESCR_PRIM(struct wire_msg, title, JSON_TOK_STRING),
    JSON_OBJ_DESCR_PRIM(struct wire_msg, text, JSON_TOK_STRING),
    JSON_OBJ_DESCR_PRIM(struct wire_msg, artist, JSON_TOK_STRING),
    JSON_OBJ_DESCR_PRIM(struct wire_msg, album, JSON_TOK_STRING),
    JSON_OBJ_DESCR_PRIM(struct wire_msg, state, JSON_TOK_STRING),
    JSON_OBJ_DESCR_PRIM(struct wire_msg, position_ms, JSON_TOK_NUMBER),
    JSON_OBJ_DESCR_PRIM(struct wire_msg, duration_ms, JSON_TOK_NUMBER),
};

/* Zephyr validates JSON escaping but deliberately leaves string escapes in
 * place. Convert standard escapes and \uXXXX to UTF-8 for a future H7 UI.
 * Reject strings too long rather than silently losing content. */
static int hexval(char c)
{
    if (c >= '0' && c <= '9') return c - '0';
    if (c >= 'a' && c <= 'f') return c - 'a' + 10;
    if (c >= 'A' && c <= 'F') return c - 'A' + 10;
    return -1;
}

static bool read_u16(const char **pp, uint32_t *out)
{
    const char *p = *pp;
    uint32_t n = 0U;
    for (int i = 0; i < 4; ++i) {
        if (p[i] == '\0') return false;
        int x = hexval(p[i]);
        if (x < 0) return false;
        n = (n << 4U) | (uint32_t)x;
    }
    *pp = p + 4;
    *out = n;
    return true;
}

static bool emit_codepoint(char *out, size_t cap, size_t *used, uint32_t cp)
{
    uint8_t tmp[4];
    size_t count;
    if (cp < 0x80U) {
        tmp[0] = (uint8_t)cp; count = 1U;
    } else if (cp < 0x800U) {
        tmp[0] = (uint8_t)(0xc0U | (cp >> 6));
        tmp[1] = (uint8_t)(0x80U | (cp & 0x3fU)); count = 2U;
    } else if (cp < 0x10000U) {
        if (cp >= 0xd800U && cp <= 0xdfffU) return false;
        tmp[0] = (uint8_t)(0xe0U | (cp >> 12));
        tmp[1] = (uint8_t)(0x80U | ((cp >> 6) & 0x3fU));
        tmp[2] = (uint8_t)(0x80U | (cp & 0x3fU)); count = 3U;
    } else if (cp <= 0x10ffffU) {
        tmp[0] = (uint8_t)(0xf0U | (cp >> 18));
        tmp[1] = (uint8_t)(0x80U | ((cp >> 12) & 0x3fU));
        tmp[2] = (uint8_t)(0x80U | ((cp >> 6) & 0x3fU));
        tmp[3] = (uint8_t)(0x80U | (cp & 0x3fU)); count = 4U;
    } else return false;
    if (*used + count >= cap) return false;
    for (size_t j = 0U; j < count; ++j) out[(*used)++] = (char)tmp[j];
    return true;
}

static bool copy_json_string(char *out, size_t cap, const char *in)
{
    if (!out || cap == 0U) return false;
    out[0] = '\0';
    if (in == NULL) return true;  /* optional string */
    size_t used = 0U;
    for (const char *p = in; *p; ++p) {
        unsigned char c = (unsigned char)*p;
        if (c == '\\') {
            c = (unsigned char)*++p;
            if (c == '\0') return false;
            if (c == 'u') {
                ++p;
                uint32_t cp;
                if (!read_u16(&p, &cp)) return false;
                if (cp >= 0xd800U && cp <= 0xdbffU) {
                    if (p[0] != '\\' || p[1] != 'u') return false;
                    p += 2;
                    uint32_t lo;
                    if (!read_u16(&p, &lo) || lo < 0xdc00U || lo > 0xdfffU) return false;
                    cp = 0x10000U + ((cp - 0xd800U) << 10) + (lo - 0xdc00U);
                }
                if (!emit_codepoint(out, cap, &used, cp)) return false;
                --p;
                continue;
            }
            if (c == 'n' || c == 'r' || c == 't' || c == 'b' || c == 'f') c = ' ';
            else if (c != '"' && c != '/' && c != '\\') return false;
        } else if (c < 32U) {
            return false;
        }
        if (used + 1U >= cap) return false;
        out[used++] = (char)c;
    }
    out[used] = '\0';
    return true;
}

int rc_app_json_ingest(char *line, rc_app_source_t source)
{
    if (line == NULL || (source != RC_APP_FROM_WIFI && source != RC_APP_FROM_BLE))
        return -EINVAL;
    size_t len = strnlen(line, RC_JSON_LINE_MAX);
    if (len == 0U || len >= RC_JSON_LINE_MAX || line[0] != '{') return -EINVAL;

    struct wire_msg w = {
        .v = -1, .seq = -1, .distance_m = -1, .speed_kmh = -1,
        .remaining_m = 0, .eta_sec = 0, .position_ms = 0, .duration_ms = 0,
        .gps = {.valid = 0},
    };
    int64_t parsed = json_obj_parse(line, len, msg_desc, ARRAY_SIZE(msg_desc), &w);
    if (parsed < 0 || w.v != 1 || w.seq < 0 || w.type == NULL) return -EINVAL;

    rc_app_message_t m = { .version = 1, .seq = (uint32_t)w.seq, .source = source };
    /* Identify the type first. Disabled source/type pairs are explicitly
     * rejected (EACCES), not misreported as malformed JSON (EINVAL).
     */
    if (strcmp(w.type, "nav") == 0) m.kind = RC_APP_NAV;
    else if (strcmp(w.type, "notification") == 0) m.kind = RC_APP_NOTIFICATION;
    else if (strcmp(w.type, "media") == 0) m.kind = RC_APP_MEDIA;
    else return -EINVAL;

    if (!rc_transport_allows(source, m.kind)) return -EACCES;

    if (m.kind == RC_APP_NAV) {
        if (w.maneuver == NULL || w.distance_m < 0 || w.distance_m > 10000000 ||
            w.speed_kmh < 0 || w.speed_kmh > 240 || w.remaining_m < 0 ||
            w.remaining_m > 100000000 || w.eta_sec < 0 || w.eta_sec > 2592000 ||
            w.gps.valid < 0 || w.gps.valid > 1 ||
            w.gps.lat_e7 < -900000000 || w.gps.lat_e7 > 900000000 ||
            w.gps.lon_e7 < -1800000000 || w.gps.lon_e7 > 1800000000) return -EINVAL;
        rc_app_nav_t *n = &m.payload.nav;
        m.kind = RC_APP_NAV;
        if (strcmp(w.maneuver, "turn_left") == 0) n->maneuver = RC_NAV_LEFT;
        else if (strcmp(w.maneuver, "turn_right") == 0) n->maneuver = RC_NAV_RIGHT;
        else if (strcmp(w.maneuver, "straight") == 0) n->maneuver = RC_NAV_STRAIGHT;
        else if (strcmp(w.maneuver, "arrived") == 0) n->maneuver = RC_NAV_ARRIVED;
        else return -EINVAL;
        n->distance_m = (uint32_t)w.distance_m;
        n->speed_kmh = (uint16_t)w.speed_kmh;
        n->remaining_m = (uint32_t)w.remaining_m;
        n->eta_sec = (uint32_t)w.eta_sec;
        n->gps_valid = w.gps.valid == 1;
        n->lat_e7 = w.gps.lat_e7;
        n->lon_e7 = w.gps.lon_e7;
        if (!copy_json_string(n->road, sizeof(n->road), w.road)) return -EINVAL;
    } else if (m.kind == RC_APP_NOTIFICATION) {
        rc_app_notification_t *n = &m.payload.notification;
        if (w.app == NULL || w.sender == NULL || w.text == NULL ||
            !copy_json_string(n->app, sizeof(n->app), w.app) ||
            !copy_json_string(n->sender, sizeof(n->sender), w.sender) ||
            !copy_json_string(n->title, sizeof(n->title), w.title) ||
            !copy_json_string(n->text, sizeof(n->text), w.text) ||
            n->app[0] == '\0') return -EINVAL;
        m.kind = RC_APP_NOTIFICATION;
    } else if (m.kind == RC_APP_MEDIA) {
        rc_app_media_t *media = &m.payload.media;
        if (w.state == NULL || w.position_ms < 0 || w.duration_ms < 0 ||
            w.position_ms > 86400000 || w.duration_ms > 86400000) return -EINVAL;
        if (strcmp(w.state, "playing") == 0) media->state = RC_MEDIA_PLAY;
        else if (strcmp(w.state, "paused") == 0) media->state = RC_MEDIA_PAUSE;
        else if (strcmp(w.state, "stopped") == 0) media->state = RC_MEDIA_STOP;
        else return -EINVAL;
        if (!copy_json_string(media->app, sizeof(media->app), w.app) ||
            !copy_json_string(media->title, sizeof(media->title), w.title) ||
            !copy_json_string(media->artist, sizeof(media->artist), w.artist) ||
            !copy_json_string(media->album, sizeof(media->album), w.album)) return -EINVAL;
        media->position_ms = (uint32_t)w.position_ms;
        media->duration_ms = (uint32_t)w.duration_ms;
        m.kind = RC_APP_MEDIA;
    } else {
        return -EINVAL;
    }
    return rc_h7_bridge_enqueue(&m) ? 0 : -ENOBUFS;
}
```

## src/rc_app_message.h
```c
/* RideCast v1 normalized application model. No transport or OLED dependencies.
 * JSON on phone links today; later UART/SPI uses the same logical fields.
 */
#ifndef RC_APP_MESSAGE_H_
#define RC_APP_MESSAGE_H_
#include <stdint.h>
#include <stdbool.h>

/* Includes terminating NUL; use newline-delimited JSON on TCP and BLE. */
#define RC_JSON_LINE_MAX 512U

typedef enum { RC_APP_FROM_WIFI = 1, RC_APP_FROM_BLE = 2 } rc_app_source_t;
typedef enum { RC_APP_NAV = 1, RC_APP_NOTIFICATION = 2, RC_APP_MEDIA = 3 } rc_app_kind_t;
typedef enum {
    RC_NAV_LEFT, RC_NAV_RIGHT, RC_NAV_STRAIGHT, RC_NAV_ARRIVED
} rc_nav_maneuver_t;
typedef enum { RC_MEDIA_PLAY, RC_MEDIA_PAUSE, RC_MEDIA_STOP } rc_media_state_t;

typedef struct {
    rc_nav_maneuver_t maneuver;
    uint32_t distance_m;
    uint16_t speed_kmh;
    uint32_t remaining_m;
    uint32_t eta_sec;
    bool gps_valid;
    int32_t lat_e7;        /* Degrees * 1e7: no floating-point JSON needed. */
    int32_t lon_e7;
    char road[64];
} rc_app_nav_t;

typedef struct {
    char app[24];
    char sender[48];
    char title[64];
    char text[144];
} rc_app_notification_t;

typedef struct {
    rc_media_state_t state;
    char app[24];
    char title[80];
    char artist[64];
    char album[64];
    uint32_t position_ms;
    uint32_t duration_ms;
} rc_app_media_t;

typedef struct {
    uint8_t version;
    rc_app_source_t source;
    rc_app_kind_t kind;
    uint32_t seq;
    union {
        rc_app_nav_t nav;
        rc_app_notification_t notification;
        rc_app_media_t media;
    } payload;
} rc_app_message_t;

/* Parse a mutable, NUL-terminated, complete JSON object; ingress is only
 * invoked AFTER transport authentication. Returns 0 or negative errno.
 * The roles accepted for each authenticated source are defined in
 * ridecast_config.h (the caller must enforce authentication).
 */
int rc_app_json_ingest(char *line, rc_app_source_t source);
#endif
```

## src/rc_ble_framing.h
```c
/* RideCast BLE v1 framed JSON stream; no Zephyr dependencies.
 * UUID / GATT transport is implemented separately in rc_demo_ble.c.
 *
 * Wire: 'R' 'C' | version(1) | flags(0) | seq_le16 | json_len_le16 |
 *       JSON bytes (no trailing NUL/newline) | crc16_le
 * CRC16-CCITT-FALSE: polynomial 0x1021, init 0xffff over header+JSON.
 * ACK is a different GATT characteristic; the decoder never sends ACKs.
 */
#ifndef RC_BLE_FRAMING_H_
#define RC_BLE_FRAMING_H_

#include <stddef.h>
#include <stdbool.h>
#include <stdint.h>
#include "rc_app_message.h"

#define RC_BLE_FRAME_VERSION       1U
#define RC_BLE_FRAME_HEADER_SIZE   8U
#define RC_BLE_FRAME_CRC_SIZE      2U
#define RC_BLE_FRAME_MAX_BYTES     (RC_BLE_FRAME_HEADER_SIZE + RC_JSON_LINE_MAX - 1U + RC_BLE_FRAME_CRC_SIZE)
#define RC_BLE_FRAME_IDLE_MS       3000U

/* Non-error return values; never pass these as rc_err_sts_t. */
#define RC_BLE_FEED_MORE          0
#define RC_BLE_FEED_COMPLETE      1
#define RC_BLE_FEED_DUPLICATE     2

struct rc_ble_frame_rx {
    uint8_t header[RC_BLE_FRAME_HEADER_SIZE];
    char json[RC_JSON_LINE_MAX];
    uint16_t header_used;
    uint16_t payload_size;
    uint16_t payload_used;
    uint16_t current_crc;
    uint16_t received_crc;
    uint16_t sequence;
    uint8_t crc_used;
    uint32_t last_byte_ms;
    bool have_last;
    uint16_t last_sequence;
    uint16_t last_crc;
};

/* Callback must copy/process json synchronously; it is a mutable shared buffer.
 * The GATT implementation ONLY enqueues it; JSON parsing runs in workqueue.
 * Return 0 if accepted for processing, negative errno otherwise.
 */
typedef int (*rc_ble_frame_handler_t)(void *context, uint16_t sequence,
                                       const char *json);

void rc_ble_frame_init(struct rc_ble_frame_rx *rx);

/* Feed arbitrary ATT fragments; may contain part of, or multiple, frames.
 * Returns MORE, COMPLETE, DUPLICATE, or negative errno. An error discards
 * the partial frame. State is per authenticated BLE connection.
 */
int rc_ble_frame_feed(struct rc_ble_frame_rx *rx, const uint8_t *bytes,
                      size_t count, uint32_t now_ms,
                      rc_ble_frame_handler_t handler, void *context);

/* Helper for phone/host simulation; returns number of bytes or 0 on failure. */
size_t rc_ble_frame_pack(uint16_t sequence, const char *json,
                         uint8_t *dest, size_t capacity);

#endif
```

## src/rc_connection_ap.h
```c
/* RideCast Wi-Fi access-point manager for Zephyr 4.4.
 * Portable application API; Zephyr's Wi-Fi driver owns the underlying radio.
 * SPDX-License-Identifier: MIT
 */
#ifndef RC_CONNECTION_AP_H_
#define RC_CONNECTION_AP_H_
#include <stdbool.h>
#include <stdint.h>
#include "rc_err_sts.h"
#ifdef __cplusplus
extern "C" {
#endif

typedef enum {
    RC_AP_STOPPED = 0,
    RC_AP_STARTING,
    RC_AP_READY,
    RC_AP_ERROR,
} rc_ap_state_t;

typedef struct {
    const char *ssid;   /* 1..32 bytes, visible as Wi-Fi network name */
    const char *psk;    /* WPA2 PSK: 8..63 bytes; NEVER the 6-digit enrollment PIN */
    uint8_t channel;    /* 1..11 for this development demonstration */
} rc_conn_ap_config_t;

typedef struct {
    rc_ap_state_t state;
    rc_err_sts_t last_error;
    uint8_t associated_stations;  /* Wi-Fi links, NOT authenticated app sessions */
} rc_conn_ap_snapshot_t;

typedef void (*rc_conn_ap_event_cb_t)(const rc_conn_ap_snapshot_t *state, void *arg);

rc_err_sts_t rc_conn_ap_init(const rc_conn_ap_config_t *cfg,
                            rc_conn_ap_event_cb_t callback, void *arg);
rc_err_sts_t rc_conn_ap_start(void);
rc_err_sts_t rc_conn_ap_stop(void);
rc_err_sts_t rc_conn_ap_snapshot(rc_conn_ap_snapshot_t *out);
bool rc_conn_ap_is_ready(void);
const char *rc_conn_ap_state_name(rc_ap_state_t state);
#ifdef __cplusplus
}
#endif
#endif
```
