## CMakeLists.txt
```
cmake_minimum_required(VERSION 3.20.0)

set(SHIELD ssd1306_128x64)

find_package(Zephyr REQUIRED HINTS $ENV{ZEPHYR_BASE})

project(emoji_notification_center)

target_sources(app PRIVATE
    src/main.c
    src/input_thread.c
    src/notification_thread.c
    src/display_thread.c
    src/emoji_draw.c
)
```

## prj.conf
```kconfig
# ============================================================================
# File        : prj.conf
# Description : Zephyr multithreading with SSD1306 OLED
# Board       : Heltec WiFi LoRa 32 V2
# ============================================================================

# ---------------------------------------------------------------------------
# GPIO and I2C
# ---------------------------------------------------------------------------
CONFIG_GPIO=y
CONFIG_I2C=y

# ---------------------------------------------------------------------------
# SSD1306 display driver
# ---------------------------------------------------------------------------
CONFIG_DISPLAY=y
CONFIG_SSD1306=y

# ---------------------------------------------------------------------------
# Character Framebuffer and Fonts
# ---------------------------------------------------------------------------
CONFIG_CHARACTER_FRAMEBUFFER=y
CONFIG_CHARACTER_FRAMEBUFFER_USE_DEFAULT_FONTS=y

# Memory required by the CFB implementation
CONFIG_HEAP_MEM_POOL_SIZE=2048

# Static thread stacks are created with K_THREAD_STACK_DEFINE().
# No CONFIG_DYNAMIC_THREAD_ALLOC is required.

# ---------------------------------------------------------------------------
# UART Console
# ---------------------------------------------------------------------------
CONFIG_CONSOLE=y
CONFIG_PRINTK=y

# ---------------------------------------------------------------------------
# Logging
# ---------------------------------------------------------------------------
CONFIG_LOG=y
CONFIG_LOG_DEFAULT_LEVEL=3
```

## app.overlay
```dts
/* ============================================================================
 * File        : app.overlay
 * Description : OLED I2C configuration and deferred initialization
 * Board       : Heltec WiFi LoRa 32 V2
 * ========================================================================== */

#include <zephyr/dt-bindings/i2c/i2c.h>

/* -------------------------------------------------------------------------- */
/* I2C Controller Configuration                                               */
/* -------------------------------------------------------------------------- */

&i2c0 {
    status = "okay";

    /*
     * Use standard I2C speed (100 kHz).
     *
     * This keeps the initial multithreading experiment
     * consistent with the working OLED example.
     */
    clock-frequency = <I2C_BITRATE_STANDARD>;
};

/* -------------------------------------------------------------------------- */
/* SSD1306 OLED Configuration                                                 */
/* -------------------------------------------------------------------------- */

&ssd1306_ssd1306_128x64 {
    status = "okay";

    /*
     * Prevent automatic SSD1306 initialization during boot.
     *
     * main() will:
     *
     * 1. Call i2c_recover_bus().
     * 2. Call device_init(oled_dev).
     * 3. Initialize the character framebuffer.
     * 4. Start all three application threads.
     *
     * This avoids the I2C -EBUSY failure encountered
     * during automatic OLED initialization.
     */
    zephyr,deferred-init;
};
```

## src/main.c
```c
/* ============================================================================
 * File        : main.c
 * Description : System initialization and static thread creation
 * Application : 06_emoji_notification_center
 * Board       : Heltec WiFi LoRa 32 V2 (ESP32)
 * Zephyr      : 4.4.0
 * ============================================================================
 *
 * Responsibilities:
 *   1. Recover the I2C bus before initializing the OLED driver.
 *   2. Initialize the deferred SSD1306 display device.
 *   3. Initialize the Character Framebuffer (CFB).
 *   4. Configure the joystick ADC channels and push buttons.
 *   5. Create input, display and notification threads with STATIC stacks.
 *
 * Thread communication:
 *   Input thread -----------+
 *                           +--> app_event_queue --> Display thread --> OLED
 *   Notification thread ----+
 *
 * The display thread is the only thread that draws or refreshes the OLED.
 *
 * UI behavior:
 *   At boot       : Help / joystick controls screen
 *   Onboard PRG   : Toggle help screen <-> emoji browser
 *   Joystick UP   : Previous category
 *   Joystick DOWN : Next category
 *   Joystick LEFT : Previous emoji
 *   Joystick RIGHT: Next emoji
 *   Joystick SW   : Select / animate current emoji
 * ============================================================================ */

#include <zephyr/kernel.h>
#include <zephyr/device.h>
#include <zephyr/devicetree.h>
#include <zephyr/drivers/i2c.h>
#include <zephyr/drivers/display.h>
#include <zephyr/display/cfb.h>
#include <zephyr/sys/printk.h>

#include <errno.h>

#include "app_events.h"

/* -------------------------------------------------------------------------- */
/* Devicetree nodes                                                           */
/* -------------------------------------------------------------------------- */

#define I2C_NODE  DT_NODELABEL(i2c0)
#define OLED_NODE DT_CHOSEN(zephyr_display)

#if !DT_NODE_EXISTS(I2C_NODE)
    #error "Missing i2c0 Devicetree node"
#endif

#if !DT_NODE_HAS_STATUS(I2C_NODE, okay)
    #error "I2C controller must be enabled"
#endif

#if !DT_HAS_CHOSEN(zephyr_display)
    #error "SSD1306 shield must set chosen zephyr,display"
#endif

#if !DT_NODE_HAS_STATUS(OLED_NODE, okay)
    #error "OLED display must be enabled"
#endif

#if !DT_NODE_HAS_PROP(OLED_NODE, zephyr_deferred_init)
    #error "OLED must have zephyr,deferred-init in app.overlay"
#endif

static const struct device* const i2c_dev  = DEVICE_DT_GET(I2C_NODE);
static const struct device* const oled_dev = DEVICE_DT_GET(OLED_NODE);

/* -------------------------------------------------------------------------- */
/* Shared application message queue                                           */
/* -------------------------------------------------------------------------- */

/*
 * The queue is defined ONCE here. Other .c files access it through
 * 'extern struct k_msgq app_event_queue;' in app_events.h.
 *
 * Each queue slot stores a COPY of struct app_event.
 */
K_MSGQ_DEFINE(app_event_queue, sizeof(struct app_event), 16, 4);

/* -------------------------------------------------------------------------- */
/* Static thread stacks and thread control blocks                             */
/* -------------------------------------------------------------------------- */

#define INPUT_THREAD_STACK_SIZE   2048
#define DISPLAY_THREAD_STACK_SIZE 3072
#define NOTIFY_THREAD_STACK_SIZE  1024

/* Lower numeric value means higher priority for preemptible threads. */
#define INPUT_THREAD_PRIORITY     5
#define DISPLAY_THREAD_PRIORITY   5
#define NOTIFY_THREAD_PRIORITY    6

K_THREAD_STACK_DEFINE(input_thread_stack, INPUT_THREAD_STACK_SIZE);
K_THREAD_STACK_DEFINE(display_thread_stack, DISPLAY_THREAD_STACK_SIZE);
K_THREAD_STACK_DEFINE(notify_thread_stack, NOTIFY_THREAD_STACK_SIZE);

static struct k_thread input_thread_data;
static struct k_thread display_thread_data;
static struct k_thread notify_thread_data;

/* -------------------------------------------------------------------------- */
/* OLED hardware initialization                                               */
/* -------------------------------------------------------------------------- */

/**
 * @brief Recover I2C, initialize deferred SSD1306 and prepare CFB.
 *
 * Our board previously returned -EBUSY during normal SSD1306 startup.
 * Delaying OLED initialization until after i2c_recover_bus() fixes that.
 *
 * @return 0 when the OLED is ready, otherwise a negative error code.
 */
static int oled_initialize(void)
{
    int status;

    /* STEP 1: I2C controller must already be ready. */
    if(!device_is_ready(i2c_dev))
    {
        printk("ERROR: I2C controller not ready\n");
        return -ENODEV;
    }

    /* STEP 2: Recover the I2C bus before SSD1306 initialization. */
    printk("OLED: recovering I2C bus...\n");
    status = i2c_recover_bus(i2c_dev);

    if(status < 0)
    {
        printk("ERROR: I2C recovery failed: %d\n", status);
        return status;
    }

    /* STEP 3: Start the OLED device marked deferred in Devicetree. */
    printk("OLED: initializing deferred SSD1306...\n");
    status = device_init(oled_dev);

    if(status < 0)
    {
        printk("ERROR: SSD1306 device_init failed: %d\n", status);
        return status;
    }

    if(!device_is_ready(oled_dev))
    {
        printk("ERROR: SSD1306 driver not ready\n");
        return -ENODEV;
    }

    /* STEP 4: Configure the monochrome OLED pixel format. */
    status = display_set_pixel_format(oled_dev, PIXEL_FORMAT_MONO01);

    if(status < 0)
    {
        printk("ERROR: OLED pixel format failed: %d\n", status);
        return status;
    }

    /* STEP 5: Initialize the CFB framebuffer. */
    status = cfb_framebuffer_init(oled_dev);

    if(status < 0)
    {
        printk("ERROR: CFB initialization failed: %d\n", status);
        return status;
    }

    /* STEP 6: Clear the in-memory framebuffer. */
    status = cfb_framebuffer_clear(oled_dev, false);

    if(status < 0)
    {
        printk("ERROR: CFB clear failed: %d\n", status);
        return status;
    }

    /* STEP 7: Turn on the physical OLED output. */
    status = display_blanking_off(oled_dev);

    if(status < 0)
    {
        printk("ERROR: OLED blanking-off failed: %d\n", status);
        return status;
    }

    printk("OLED: SSD1306 and CFB ready\n");
    return 0;
}

/* -------------------------------------------------------------------------- */
/* Application main                                                           */
/* -------------------------------------------------------------------------- */

/**
 * @brief Initialize hardware and create all three Zephyr threads.
 *
 * @return 0 on successful startup or a negative error code.
 */
int main(void)
{
    int status;

    printk("\n========================================\n");
    printk(" Example 06: Emoji Notification Center\n");
    printk(" Zephyr RTOS / Heltec WiFi LoRa 32 V2\n");
    printk("========================================\n");

    /*
     * STEP 1: Initialize the OLED before any worker thread
     * can start drawing.
     */
    status = oled_initialize();

    if(status < 0)
    {
        printk("ERROR: OLED initialization failed: %d\n", status);
        return status;
    }

    /*
     * STEP 2: Configure joystick X/Y ADC channels,
     * joystick SW and onboard PRG button.
     */
    status = input_thread_init();

    if(status < 0)
    {
        printk("ERROR: Input initialization failed: %d\n", status);
        return status;
    }

    /*
     * STEP 3: Create the display thread first.
     *
     * This thread owns the OLED and initially displays
     * the joystick help / controls screen.
     */
    (void)k_thread_create(&display_thread_data, display_thread_stack,
                          K_THREAD_STACK_SIZEOF(display_thread_stack), display_thread_entry,
                          NULL, NULL, NULL, DISPLAY_THREAD_PRIORITY, 0, K_NO_WAIT);

    /*
     * STEP 4: Create the input thread.
     *
     * This thread reads joystick movement and button presses.
     * All user interactions are sent through app_event_queue.
     */
    (void)k_thread_create(&input_thread_data, input_thread_stack,
                          K_THREAD_STACK_SIZEOF(input_thread_stack), input_thread_entry,
                          NULL, NULL, NULL, INPUT_THREAD_PRIORITY, 0, K_NO_WAIT);

    /*
     * STEP 5: Create the notification thread.
     *
     * Generates simulated notifications and sends them
     * to the same application message queue.
     */
    (void)k_thread_create(&notify_thread_data, notify_thread_stack,
                          K_THREAD_STACK_SIZEOF(notify_thread_stack), notification_thread_entry,
                          NULL, NULL, NULL, NOTIFY_THREAD_PRIORITY, 0, K_NO_WAIT);

    printk("APP: three static threads created\n");
    printk("APP: PRG toggles help/browser\n");
    printk("APP: joystick controls emojis\n");

    /*
     * main() may return here.
     *
     * The three worker threads continue running under
     * the Zephyr scheduler.
     */
    return 0;
}
```

## src/app_events.h
```c
/* ============================================================================
 * File        : app_events.h
 * Description : Shared application events and message queue declarations
 * Application : 06_emoji_notification_center
 * ========================================================================== */

#ifndef APP_EVENTS_H_
#define APP_EVENTS_H_

#include <zephyr/kernel.h>
#include <stdint.h>

/* -------------------------------------------------------------------------- */
/* Event Types                                                                */
/* -------------------------------------------------------------------------- */

enum app_event_type
{
    /* Onboard PRG button: toggle help / emoji browser. */
    APP_EVENT_TOGGLE_SCREEN,

    /* Joystick vertical movement: change category. */
    APP_EVENT_CATEGORY_PREVIOUS,
    APP_EVENT_CATEGORY_NEXT,

    /* Joystick horizontal movement: change emoji. */
    APP_EVENT_EMOJI_PREVIOUS,
    APP_EVENT_EMOJI_NEXT,

    /* Joystick SW button: select an emoji. */
    APP_EVENT_EMOJI_SELECT,

    /* Future: automatically generated notifications. */
    APP_EVENT_NOTIFICATION
};

/* -------------------------------------------------------------------------- */
/* Event Sources                                                              */
/* -------------------------------------------------------------------------- */

enum app_event_source
{
    APP_EVENT_SOURCE_PRG,
    APP_EVENT_SOURCE_JOYSTICK,
    APP_EVENT_SOURCE_SYSTEM
};

/* -------------------------------------------------------------------------- */
/* Message Structure                                                          */
/* -------------------------------------------------------------------------- */

/**
 * @brief Message exchanged between application threads.
 *
 * type      : What happened?
 * source    : Which component generated the event?
 * value     : Optional data, e.g. notification emoji ID.
 * timestamp : System uptime when the event was created.
 */
struct app_event
{
    enum app_event_type type;
    enum app_event_source source;

    int32_t value;
    uint32_t timestamp_ms;
};

/* -------------------------------------------------------------------------- */
/* Shared Zephyr Message Queue                                                */
/* -------------------------------------------------------------------------- */

/*
 * The queue is defined exactly once in main.c:
 *
 * K_MSGQ_DEFINE(app_event_queue,
 *               sizeof(struct app_event),
 *               16,
 *               4);
 *
 * All other source files access the same queue.
 */
extern struct k_msgq app_event_queue;

/* -------------------------------------------------------------------------- */
/* Input Thread Public Functions                                              */
/* -------------------------------------------------------------------------- */

/**
 * @brief Initialize the joystick ADC channels and buttons.
 *
 * Call once from main() before starting the input thread.
 */
int input_thread_init(void);

/**
 * @brief Input thread entry function.
 */
void input_thread_entry(void* arg1, void* arg2, void* arg3);

void display_thread_entry(void* arg1, void* arg2, void* arg3);

void notification_thread_entry(void* arg1, void* arg2, void* arg3);

#endif /* APP_EVENTS_H_ */
```

## src/display_thread.c
```c
/* ============================================================================
 * File        : display_thread.c
 * Description : Event-driven OLED UI for the emoji notification center
 * Board       : Heltec WiFi LoRa 32 V2 | Zephyr 4.4.0
 * ============================================================================
 *
 * Screen flow:
 *   Power on     -> HELP screen (joystick control diagram)
 *   PRG press    -> EMOJI BROWSER
 *   PRG again    -> HELP screen
 *   Joystick X   -> Previous / next emoji
 *   Joystick Y   -> Previous / next category
 *   Joystick SW  -> Select icon (short blinking animation)
 *   System event -> Temporary notification (browser only)
 *
 * This is the ONLY thread that calls CFB or draws on the OLED.
 * main() must initialize I2C, the deferred SSD1306 device and CFB first.
 * ========================================================================== */

#include <zephyr/kernel.h>
#include <zephyr/device.h>
#include <zephyr/devicetree.h>
#include <zephyr/display/cfb.h>
#include <zephyr/sys/printk.h>

#include <errno.h>
#include <stdbool.h>
#include <stdint.h>
#include <stddef.h>
#include <string.h>

#include "app_events.h"
#include "emoji_draw.h"

/* -------------------------------------------------------------------------- */
/* Configuration                                                              */
/* -------------------------------------------------------------------------- */

#define OLED_NODE               DT_CHOSEN(zephyr_display)
#define OLED_WIDTH_PIXELS       128
#define UI_EVENT_POLL_MS        50
#define UI_ANIMATION_FRAME_MS   250
#define UI_SELECTION_TIME_MS    1500
#define UI_NOTIFICATION_TIME_MS 2000

#if !DT_HAS_CHOSEN(zephyr_display)
    #error "Select the SSD1306 display in Devicetree"
#endif

static const struct device* const oled_dev = DEVICE_DT_GET(OLED_NODE);

/* -------------------------------------------------------------------------- */
/* UI State                                                                   */
/* -------------------------------------------------------------------------- */

enum ui_page
{
    UI_PAGE_HELP,
    UI_PAGE_BROWSER
};

enum ui_overlay
{
    UI_OVERLAY_NONE,
    UI_OVERLAY_SELECTION,
    UI_OVERLAY_NOTIFICATION
};

struct ui_state
{
    enum ui_page page;
    enum emoji_category category;
    size_t icon_index;

    enum ui_overlay overlay;
    enum emoji_type overlay_icon;
    bool icon_visible;
    int64_t overlay_deadline_ms;
    int64_t next_frame_ms;

    bool redraw;
};

/* Width of the selected monospace bitmap font; used for text clipping. */
static uint8_t font_width = 8U;

/* Return an error as soon as a framebuffer operation fails. */
#define UI_CHECK(expression)       \
    do                             \
    {                              \
        int ui_rc_ = (expression); \
        if(ui_rc_ < 0)             \
        {                          \
            return ui_rc_;         \
        }                          \
    } while(false)

/* -------------------------------------------------------------------------- */
/* Drawing Helpers                                                            */
/* -------------------------------------------------------------------------- */

static int ui_line(int16_t x1, int16_t y1, int16_t x2, int16_t y2)
{
    const struct cfb_position start = { x1, y1 };
    const struct cfb_position end   = { x2, y2 };

    return cfb_draw_line(oled_dev, &start, &end);
}

/* Print only the characters that can fit on the 128-pixel-wide display. */
static int ui_text(const char* text, int16_t x, int16_t y)
{
    char clipped[24];
    size_t max_chars;
    size_t length;

    if(x < 0 || x >= OLED_WIDTH_PIXELS)
    {
        return -EINVAL;
    }

    max_chars = (size_t)(OLED_WIDTH_PIXELS - x) / font_width;
    if(max_chars > sizeof(clipped) - 1U)
    {
        max_chars = sizeof(clipped) - 1U;
    }

    length = strlen(text);
    if(length > max_chars)
    {
        length = max_chars;
    }

    memcpy(clipped, text, length);
    clipped[length] = '\0';

    return cfb_print(oled_dev, clipped, x, y);
}

/* Prefer an 8-pixel-high or smaller font so help-screen labels fit. */
static void ui_select_compact_font(void)
{
    int count = cfb_get_numof_fonts(oled_dev);

    for(int i = 0; i < count; ++i)
    {
        uint8_t width  = 0;
        uint8_t height = 0;

        if(cfb_get_font_size(oled_dev, (uint8_t)i, &width, &height) == 0 &&
           width > 0U && width <= 8U && height <= 8U &&
           cfb_framebuffer_set_font(oled_dev, (uint8_t)i) == 0)
        {
            font_width = width;
            printk("UI: selected CFB font %d (%ux%u)\n", i, width, height);
            return;
        }
    }

    printk("UI: no 8-pixel font found; using default font\n");
}

/* -------------------------------------------------------------------------- */
/* Screen 1: Help / Joystick Controls                                         */
/* -------------------------------------------------------------------------- */

static int ui_draw_help(void)
{
    const struct cfb_position select_center = { 64, 35 };

    UI_CHECK(ui_text("EMOJI CONTROLS", 0, 0));

    /* Up arrow = previous category. */
    UI_CHECK(ui_line(64, 14, 64, 25));
    UI_CHECK(ui_line(64, 14, 58, 20));
    UI_CHECK(ui_line(64, 14, 70, 20));
    UI_CHECK(ui_text("CAT", 77, 15));

    /* Left arrow = previous emoji. */
    UI_CHECK(ui_line(42, 35, 31, 35));
    UI_CHECK(ui_line(31, 35, 37, 29));
    UI_CHECK(ui_line(31, 35, 37, 41));
    UI_CHECK(ui_text("PREV", 0, 31));

    /* Middle circle = joystick SW button. */
    UI_CHECK(cfb_draw_circle(oled_dev, &select_center, 10));
    UI_CHECK(ui_text("SW", 57, 31));

    /* Right arrow = next emoji. */
    UI_CHECK(ui_line(86, 35, 97, 35));
    UI_CHECK(ui_line(97, 35, 91, 29));
    UI_CHECK(ui_line(97, 35, 91, 41));
    UI_CHECK(ui_text("NXT", 103, 31));

    /* Down arrow = next category. */
    UI_CHECK(ui_line(64, 45, 64, 54));
    UI_CHECK(ui_line(64, 54, 58, 48));
    UI_CHECK(ui_line(64, 54, 70, 48));
    UI_CHECK(ui_text("CAT", 77, 45));

    UI_CHECK(ui_text("PRG: OPEN/BACK", 0, 56));
    return 0;
}

/* -------------------------------------------------------------------------- */
/* Screen 2: Emoji Browser                                                    */
/* -------------------------------------------------------------------------- */

static int ui_draw_browser(const struct ui_state* ui)
{
    enum emoji_type icon = emoji_category_icon(ui->category, ui->icon_index);

    if(icon == EMOJI_COUNT)
    {
        return -EINVAL;
    }

    UI_CHECK(ui_text(emoji_category_name(ui->category), 0, 0));
    UI_CHECK(ui_text(emoji_name(icon), 0, 10));
    UI_CHECK(ui_line(0, 19, 127, 19));

    /* Existing 54-icon module draws only; it does not clear or finalize. */
    return draw_icon(icon);
}

/* -------------------------------------------------------------------------- */
/* Temporary Selection / Notification Screens                                 */
/* -------------------------------------------------------------------------- */

static int ui_draw_overlay(const struct ui_state* ui)
{
    if(ui->overlay == UI_OVERLAY_SELECTION)
    {
        UI_CHECK(ui_text("SELECTED", 0, 0));
    }
    else
    {
        UI_CHECK(ui_text("NOTIFICATION", 0, 0));
    }

    UI_CHECK(ui_text(emoji_name(ui->overlay_icon), 0, 10));
    UI_CHECK(ui_line(0, 19, 127, 19));

    /* Blink the icon to make the selection/alert visibly animated. */
    if(ui->icon_visible)
    {
        UI_CHECK(draw_icon(ui->overlay_icon));
    }

    return 0;
}

static int ui_render(const struct ui_state* ui)
{
    int rc;

    UI_CHECK(cfb_framebuffer_clear(oled_dev, false));

    if(ui->page == UI_PAGE_HELP)
    {
        rc = ui_draw_help();
    }
    else if(ui->overlay != UI_OVERLAY_NONE)
    {
        rc = ui_draw_overlay(ui);
    }
    else
    {
        rc = ui_draw_browser(ui);
    }

    if(rc < 0)
    {
        return rc;
    }

    return cfb_framebuffer_finalize(oled_dev);
}

/* -------------------------------------------------------------------------- */
/* UI State Machine                                                           */
/* -------------------------------------------------------------------------- */

static void
ui_start_overlay(struct ui_state* ui, enum ui_overlay overlay, enum emoji_type icon, int64_t now_ms)
{
    ui->overlay      = overlay;
    ui->overlay_icon = icon;
    ui->icon_visible = true;
    ui->overlay_deadline_ms =
    now_ms + ((overlay == UI_OVERLAY_SELECTION) ? UI_SELECTION_TIME_MS : UI_NOTIFICATION_TIME_MS);
    ui->next_frame_ms = now_ms + UI_ANIMATION_FRAME_MS;
    ui->redraw        = true;
}

static void ui_change_category(struct ui_state* ui, bool next)
{
    const int count = EMOJI_CATEGORY_COUNT;
    int current     = (int)ui->category;

    current        = (current + (next ? 1 : count - 1)) % count;
    ui->category   = (enum emoji_category)current;
    ui->icon_index = 0U;
    ui->overlay    = UI_OVERLAY_NONE;
    ui->redraw     = true;
}

static void ui_change_icon(struct ui_state* ui, bool next)
{
    size_t count = emoji_category_icon_count(ui->category);

    if(count == 0U)
    {
        return;
    }

    ui->icon_index =
    next ? (ui->icon_index + 1U) % count : (ui->icon_index + count - 1U) % count;
    ui->overlay = UI_OVERLAY_NONE;
    ui->redraw  = true;
}

static void ui_handle_event(struct ui_state* ui, const struct app_event* event)
{
    int64_t now_ms = k_uptime_get();

    /* PRG toggles the initial help screen and the emoji browser. */
    if(event->type == APP_EVENT_TOGGLE_SCREEN)
    {
        ui->page = (ui->page == UI_PAGE_HELP) ? UI_PAGE_BROWSER : UI_PAGE_HELP;
        ui->overlay = UI_OVERLAY_NONE;
        ui->redraw  = true;
        return;
    }

    /* Ignore navigation and simulated notifications while on the help screen. */
    if(ui->page == UI_PAGE_HELP)
    {
        return;
    }

    switch(event->type)
    {
        case APP_EVENT_CATEGORY_PREVIOUS:
            ui_change_category(ui, false);
            break;
        case APP_EVENT_CATEGORY_NEXT:
            ui_change_category(ui, true);
            break;
        case APP_EVENT_EMOJI_PREVIOUS:
            ui_change_icon(ui, false);
            break;
        case APP_EVENT_EMOJI_NEXT:
            ui_change_icon(ui, true);
            break;
        case APP_EVENT_EMOJI_SELECT:
            ui_start_overlay(ui, UI_OVERLAY_SELECTION,
                             emoji_category_icon(ui->category, ui->icon_index), now_ms);
            break;
        case APP_EVENT_NOTIFICATION:
            if(ui->overlay == UI_OVERLAY_NONE && event->value >= 0 && event->value < EMOJI_COUNT)
            {
                ui_start_overlay(ui, UI_OVERLAY_NOTIFICATION,
                                 (enum emoji_type)event->value, now_ms);
            }
            break;
        default:
            break;
    }
}

static void ui_update_animation(struct ui_state* ui)
{
    int64_t now_ms;

    if(ui->page != UI_PAGE_BROWSER || ui->overlay == UI_OVERLAY_NONE)
    {
        return;
    }

    now_ms = k_uptime_get();

    if(now_ms >= ui->overlay_deadline_ms)
    {
        /* Return automatically to the emoji browser. */
        ui->overlay = UI_OVERLAY_NONE;
        ui->redraw  = true;
    }
    else if(now_ms >= ui->next_frame_ms)
    {
        ui->icon_visible  = !ui->icon_visible;
        ui->next_frame_ms = now_ms + UI_ANIMATION_FRAME_MS;
        ui->redraw        = true;
    }
}

/* -------------------------------------------------------------------------- */
/* Display Thread Entry                                                       */
/* -------------------------------------------------------------------------- */

void display_thread_entry(void* arg1, void* arg2, void* arg3)
{
    struct ui_state ui = {
        .page         = UI_PAGE_HELP,
        .category     = EMOJI_CATEGORY_FACES,
        .icon_index   = 0U,
        .overlay      = UI_OVERLAY_NONE,
        .overlay_icon = EMOJI_SMILE,
        .icon_visible = true,
        .redraw       = true,
    };

    ARG_UNUSED(arg1);
    ARG_UNUSED(arg2);
    ARG_UNUSED(arg3);

    if(!device_is_ready(oled_dev))
    {
        printk("UI: OLED not ready; initialize it in main() first\n");
        return;
    }

    ui_select_compact_font();
    printk("UI: display thread started (help screen)\n");

    while(true)
    {
        struct app_event event;
        int rc;

        ui_update_animation(&ui);

        if(ui.redraw)
        {
            rc = ui_render(&ui);
            if(rc < 0)
            {
                printk("UI: display draw failed: %d\n", rc);
            }
            ui.redraw = false;
        }

        /* Poll the queue with a short timeout so animations remain responsive. */
        rc = k_msgq_get(&app_event_queue, &event, K_MSEC(UI_EVENT_POLL_MS));

        if(rc == 0)
        {
            ui_handle_event(&ui, &event);
        }
        else if(rc != -EAGAIN)
        {
            printk("UI: queue receive failed: %d\n", rc);
        }
    }
}
```

## src/emoji_draw.h
```c
/* ============================================================================
 * File        : emoji_draw.h
 * Description : Emoji gallery drawing and category navigation API
 * Target      : Zephyr RTOS + 128x64 SSD1306 character framebuffer
 * ============================================================================
 * Drawing functions do not clear or flush the framebuffer.
 * Only the OLED/UI thread should access these routines.
 * ========================================================================== */

#ifndef APP_EMOJI_DRAW_H_
#define APP_EMOJI_DRAW_H_

#include <stddef.h>

#ifdef __cplusplus
extern "C"
{
#endif

    enum emoji_type
    {
        /* Facial expressions (18) */
        EMOJI_SMILE,
        EMOJI_SAD,
        EMOJI_NEUTRAL,
        EMOJI_WINK,
        EMOJI_SURPRISED,
        EMOJI_ANGRY,
        EMOJI_GRIN,
        EMOJI_LAUGH,
        EMOJI_CRY,
        EMOJI_HAPPY_TEARS,
        EMOJI_SLEEPY,
        EMOJI_COOL,
        EMOJI_LOVE_EYES,
        EMOJI_TONGUE,
        EMOJI_CONFUSED,
        EMOJI_KISS,
        EMOJI_SCARED,
        EMOJI_BLUSH,

        /* Love and feelings (2) */
        EMOJI_HEART,
        EMOJI_BROKEN_HEART,

        /* Connectivity symbols (2) */
        EMOJI_WIFI,
        EMOJI_BLUETOOTH,

        /* Nature and weather (13) */
        EMOJI_STAR,
        EMOJI_SUN,
        EMOJI_MOON,
        EMOJI_CLOUD,
        EMOJI_RAIN,
        EMOJI_LIGHTNING,
        EMOJI_SNOWFLAKE,
        EMOJI_FIRE,
        EMOJI_WATER_DROP,
        EMOJI_TREE,
        EMOJI_FLOWER,
        EMOJI_LEAF,
        EMOJI_MOUNTAIN,

        /* Transport (4) */
        EMOJI_ROCKET,
        EMOJI_AIRPLANE,
        EMOJI_CAR,
        EMOJI_BICYCLE,

        /* Electronics and status (7) */
        EMOJI_BATTERY,
        EMOJI_BATTERY_CHARGING,
        EMOJI_LOCK,
        EMOJI_UNLOCK,
        EMOJI_BELL,
        EMOJI_CLOCK,
        EMOJI_GEAR,

        /* Objects and symbols (8) */
        EMOJI_HOME,
        EMOJI_MUSIC,
        EMOJI_GIFT,
        EMOJI_UMBRELLA,
        EMOJI_CHECK,
        EMOJI_CROSS,
        EMOJI_ARROW_UP,
        EMOJI_ARROW_DOWN,

        EMOJI_COUNT /* Sentinel, not an icon; always keep last. */
    };

    enum emoji_category
    {
        EMOJI_CATEGORY_FACES,
        EMOJI_CATEGORY_LOVE,
        EMOJI_CATEGORY_CONNECTIVITY,
        EMOJI_CATEGORY_NATURE,
        EMOJI_CATEGORY_TRANSPORT,
        EMOJI_CATEGORY_ELECTRONICS,
        EMOJI_CATEGORY_OBJECTS,
        EMOJI_CATEGORY_COUNT /* Sentinel; always keep last. */
    };

    /**
     * @brief Draw the selected icon into the existing CFB RAM framebuffer.
     *
     * Prerequisites: OLED driver and CFB have been initialized in main().
     * This function does NOT clear or transfer the framebuffer.
     *
     * @param icon Icon ID from enum emoji_type.
     * @return 0 on success, or a negative errno-style value on failure.
     */
    int draw_icon(enum emoji_type icon);

    /** @return Icon label, or "INVALID" for an invalid ID. */
    const char* emoji_name(enum emoji_type icon);

    /** @return Category label, or "INVALID" for an invalid category. */
    const char* emoji_category_name(enum emoji_category category);

    /** @return Number of icons in the category (0 for invalid category). */
    size_t emoji_category_icon_count(enum emoji_category category);

    /**
     * @brief Map a category-relative index to an enum emoji_type.
     *
     * @return EMOJI_COUNT if the category or index is invalid.
     */
    enum emoji_type emoji_category_icon(enum emoji_category category, size_t index);

#ifdef __cplusplus
}
#endif

#endif /* APP_EMOJI_DRAW_H_ */
```

## src/input_thread.c
```c
/* ============================================================================
 * File        : input_thread.c
 * Description : Joystick and PRG input handling using Zephyr ADC/GPIO
 * Application : 06_emoji_notification_center
 * Board       : Heltec WiFi LoRa 32 V2
 * Zephyr      : 4.4.0
 * ============================================================================
 *
 * Hardware:
 *   GPIO36 : Joystick VRx (ADC1 channel 0)
 *   GPIO39 : Joystick VRy (ADC1 channel 3)
 *   GPIO13 : Joystick SW, active LOW
 *   GPIO0  : Onboard PRG button, active LOW
 *
 * Features:
 *   1. Read analog joystick X and Y.
 *   2. Convert analog readings to direction events.
 *   3. Debounce joystick SW and onboard PRG.
 *   4. Publish events using Zephyr k_msgq.
 *   5. Prevent repeated navigation while holding joystick.
 *
 * ========================================================================== */

#include <zephyr/kernel.h>
#include <zephyr/device.h>
#include <zephyr/devicetree.h>

#include <zephyr/drivers/adc.h>
#include <zephyr/drivers/gpio.h>

#include <zephyr/sys/printk.h>

#include <errno.h>
#include <stdbool.h>
#include <stdint.h>

#include "app_events.h"

/* -------------------------------------------------------------------------- */
/* Configuration                                                              */
/* -------------------------------------------------------------------------- */

#define INPUT_POLL_INTERVAL_MS  50

#define BUTTON_DEBOUNCE_SAMPLES 3

/*
 * Joystick ADC thresholds for 12-bit readings.
 *
 * These are starting values. Adjust them after observing
 * the actual neutral and extreme ADC readings.
 */
#define JOY_LOW_THRESHOLD       1100
#define JOY_HIGH_THRESHOLD      3200

/*
 * A wider neutral release region prevents accidental
 * repeated navigation due to ADC noise.
 */
#define JOY_CENTER_MIN          1500
#define JOY_CENTER_MAX          2700

/* Joystick SW is connected to GPIO13. */
#define JOYSTICK_SW_PIN         13

/* -------------------------------------------------------------------------- */
/* Devicetree References                                                      */
/* -------------------------------------------------------------------------- */

#define ADC_USER_NODE           DT_PATH(zephyr_user)
#define PRG_NODE                DT_ALIAS(sw0)
#define GPIO_NODE               DT_NODELABEL(gpio0)

/*
 * The overlay must provide:
 *
 * zephyr,user {
 *     io-channels = <&adc0 0>, <&adc0 3>;
 * };
 *
 * IMPORTANT:
 * Zephyr names the ESP32's ADC1 hardware controller "adc0".
 */
#if !DT_NODE_EXISTS(ADC_USER_NODE)
    #error "Missing zephyr,user ADC configuration in app.overlay"
#endif

#if !DT_NODE_EXISTS(PRG_NODE)
    #error "Missing onboard PRG button alias sw0"
#endif

static const struct adc_dt_spec joystick_x = ADC_DT_SPEC_GET_BY_IDX(ADC_USER_NODE, 0);

static const struct adc_dt_spec joystick_y = ADC_DT_SPEC_GET_BY_IDX(ADC_USER_NODE, 1);

/* Onboard PRG button from the board definition. */
static const struct gpio_dt_spec prg_button = GPIO_DT_SPEC_GET(PRG_NODE, gpios);

/* GPIO controller for joystick SW. */
static const struct device* const gpio_dev = DEVICE_DT_GET(GPIO_NODE);

/* -------------------------------------------------------------------------- */
/* Debounce State                                                             */
/* -------------------------------------------------------------------------- */

struct button_state
{
    bool last_sample;
    bool stable_pressed;
    uint8_t consecutive_samples;
};

/* Each physical button maintains its own debounce state. */
static struct button_state prg_state;
static struct button_state joystick_sw_state;

/* -------------------------------------------------------------------------- */
/* Queue Event Publisher                                                      */
/* -------------------------------------------------------------------------- */

/**
 * @brief Send one event without blocking the input thread.
 */
static void input_publish_event(enum app_event_type type, enum app_event_source source)
{
    struct app_event event = {
        .type = type, .source = source, .value = 0, .timestamp_ms = k_uptime_get_32()
    };

    /*
     * K_NO_WAIT ensures the input thread does not stop
     * if the display thread is currently busy.
     */
    int status = k_msgq_put(&app_event_queue, &event, K_NO_WAIT);

    if(status < 0)
    {
        printk("INPUT: Event dropped, queue full: %d\n", status);
    }
}

/* -------------------------------------------------------------------------- */
/* Analog Input                                                               */
/* -------------------------------------------------------------------------- */

/**
 * @brief Read one joystick ADC channel.
 *
 * @param channel ADC channel specification.
 * @param value   Output raw ADC sample.
 *
 * @return 0 on success, negative error code on failure.
 */
static int input_read_axis(const struct adc_dt_spec* channel, int16_t* value)
{
    int16_t sample = 0;

    struct adc_sequence sequence = { .buffer = &sample, .buffer_size = sizeof(sample) };

    int status = adc_sequence_init_dt(channel, &sequence);

    if(status < 0)
    {
        return status;
    }

    status = adc_read_dt(channel, &sequence);

    if(status < 0)
    {
        return status;
    }

    *value = sample;

    return 0;
}

/* -------------------------------------------------------------------------- */
/* Button Debouncing                                                          */
/* -------------------------------------------------------------------------- */

/**
 * @brief Detect a debounced button press.
 *
 * Three consecutive identical samples are required
 * before accepting a change.
 *
 * Only the transition from RELEASED to PRESSED
 * generates an event.
 */
static bool input_button_pressed(struct button_state* state, bool currently_pressed)
{
    if(currently_pressed != state->last_sample)
    {
        state->last_sample         = currently_pressed;
        state->consecutive_samples = 1U;
    }
    else if(state->consecutive_samples < BUTTON_DEBOUNCE_SAMPLES)
    {
        state->consecutive_samples++;
    }

    if(state->consecutive_samples >= BUTTON_DEBOUNCE_SAMPLES)
    {
        if(state->stable_pressed != currently_pressed)
        {
            state->stable_pressed = currently_pressed;

            if(currently_pressed)
            {
                return true;
            }
        }
    }

    return false;
}

/* -------------------------------------------------------------------------- */
/* Joystick Direction Handling                                                */
/* -------------------------------------------------------------------------- */

/**
 * @brief Convert X-axis movement to emoji-navigation events.
 *
 * LEFT  -> Previous emoji
 * RIGHT -> Next emoji
 *
 * A new movement is accepted only after returning
 * the joystick to its neutral position.
 */
static void input_process_x_axis(int16_t x, bool* armed)
{
    if(x >= JOY_CENTER_MIN && x <= JOY_CENTER_MAX)
    {
        *armed = true;
        return;
    }

    if(!*armed)
    {
        return;
    }

    if(x <= JOY_LOW_THRESHOLD)
    {
        input_publish_event(APP_EVENT_EMOJI_PREVIOUS, APP_EVENT_SOURCE_JOYSTICK);
        *armed = false;
    }
    else if(x >= JOY_HIGH_THRESHOLD)
    {
        input_publish_event(APP_EVENT_EMOJI_NEXT, APP_EVENT_SOURCE_JOYSTICK);
        *armed = false;
    }
}

/**
 * @brief Convert Y-axis movement to category-navigation events.
 *
 * UP   -> Previous category
 * DOWN -> Next category
 */
static void input_process_y_axis(int16_t y, bool* armed)
{
    if(y >= JOY_CENTER_MIN && y <= JOY_CENTER_MAX)
    {
        *armed = true;
        return;
    }

    if(!*armed)
    {
        return;
    }

    if(y <= JOY_LOW_THRESHOLD)
    {
        input_publish_event(APP_EVENT_CATEGORY_PREVIOUS, APP_EVENT_SOURCE_JOYSTICK);
        *armed = false;
    }
    else if(y >= JOY_HIGH_THRESHOLD)
    {
        input_publish_event(APP_EVENT_CATEGORY_NEXT, APP_EVENT_SOURCE_JOYSTICK);
        *armed = false;
    }
}

/* -------------------------------------------------------------------------- */
/* Hardware Initialization                                                    */
/* -------------------------------------------------------------------------- */

/**
 * @brief Initialize ADC X/Y and both push buttons.
 *
 * Called from main() before thread creation.
 */
int input_thread_init(void)
{
    int status;

    /* STEP 1: Check ADC and GPIO controllers. */
    if(!adc_is_ready_dt(&joystick_x) || !adc_is_ready_dt(&joystick_y))
    {
        printk("ERROR: Joystick ADC controller not ready\n");
        return -ENODEV;
    }

    if(!device_is_ready(gpio_dev) || !gpio_is_ready_dt(&prg_button))
    {
        printk("ERROR: Input GPIO controller not ready\n");
        return -ENODEV;
    }

    /* STEP 2: Configure joystick X-axis channel. */
    status = adc_channel_setup_dt(&joystick_x);

    if(status < 0)
    {
        printk("ERROR: Joystick X ADC setup: %d\n", status);
        return status;
    }

    /* STEP 3: Configure joystick Y-axis channel. */
    status = adc_channel_setup_dt(&joystick_y);

    if(status < 0)
    {
        printk("ERROR: Joystick Y ADC setup: %d\n", status);
        return status;
    }

    /* STEP 4: Configure onboard PRG button. */
    status = gpio_pin_configure_dt(&prg_button, GPIO_INPUT);

    if(status < 0)
    {
        printk("ERROR: PRG button setup: %d\n", status);
        return status;
    }

    /*
     * STEP 5: Configure joystick SW as active-low input.
     *
     * The joystick switch connects SW to GND when pressed.
     * The pull-up keeps the input HIGH when released.
     */
    status = gpio_pin_configure(gpio_dev, JOYSTICK_SW_PIN, GPIO_INPUT | GPIO_PULL_UP);

    if(status < 0)
    {
        printk("ERROR: Joystick SW setup: %d\n", status);
        return status;
    }

    printk("INPUT: Joystick and buttons initialized\n");

    return 0;
}

/* -------------------------------------------------------------------------- */
/* Input Thread                                                               */
/* -------------------------------------------------------------------------- */

/**
 * @brief Read joystick and button inputs periodically.
 *
 * The input thread is a producer.
 *
 * It sends UI events through app_event_queue and never
 * directly modifies the OLED framebuffer.
 */
void input_thread_entry(void* arg1, void* arg2, void* arg3)
{
    ARG_UNUSED(arg1);
    ARG_UNUSED(arg2);
    ARG_UNUSED(arg3);

    bool x_armed = true;
    bool y_armed = true;

    int16_t x_value;
    int16_t y_value;

    printk("INPUT: Thread started\n");

    while(true)
    {
        int status;

        /* -------------------------------------------------------------- */
        /* STEP 1: Read joystick X-axis.                                   */
        /* -------------------------------------------------------------- */

        status = input_read_axis(&joystick_x, &x_value);

        if(status == 0)
        {
            input_process_x_axis(x_value, &x_armed);
        }
        else
        {
            printk("INPUT: X ADC read failed: %d\n", status);
        }

        /* -------------------------------------------------------------- */
        /* STEP 2: Read joystick Y-axis.                                   */
        /* -------------------------------------------------------------- */

        status = input_read_axis(&joystick_y, &y_value);

        if(status == 0)
        {
            input_process_y_axis(y_value, &y_armed);
        }
        else
        {
            printk("INPUT: Y ADC read failed: %d\n", status);
        }

        /* -------------------------------------------------------------- */
        /* STEP 3: Read onboard PRG button.                                */
        /* -------------------------------------------------------------- */

        int prg_pressed = gpio_pin_get_dt(&prg_button);

        /*
         * gpio_pin_get_dt() respects GPIO_ACTIVE_LOW,
         * so 1 means pressed.
         */
        if(prg_pressed >= 0)
        {
            if(input_button_pressed(&prg_state, prg_pressed != 0))
            {
                input_publish_event(APP_EVENT_TOGGLE_SCREEN, APP_EVENT_SOURCE_PRG);
            }
        }

        /* -------------------------------------------------------------- */
        /* STEP 4: Read joystick SW button.                                */
        /* -------------------------------------------------------------- */

        int sw_level = gpio_pin_get_raw(gpio_dev, JOYSTICK_SW_PIN);

        /*
         * SW is active LOW:
         *   0 = Pressed
         *   1 = Released
         */
        if(sw_level >= 0)
        {
            if(input_button_pressed(&joystick_sw_state, sw_level == 0))
            {
                input_publish_event(APP_EVENT_EMOJI_SELECT, APP_EVENT_SOURCE_JOYSTICK);
            }
        }

        /* -------------------------------------------------------------- */
        /* STEP 5: Sleep until next input scan.                            */
        /* -------------------------------------------------------------- */

        k_sleep(K_MSEC(INPUT_POLL_INTERVAL_MS));
    }
}
```

## src/notification_thread.c
```c
/* ============================================================================
 * File        : notification_thread.c
 * Description : Simulated system notifications sent to the OLED UI queue
 * Application : 06_emoji_notification_center
 * ============================================================================
 *
 * No physical battery, network, or weather sensor is read here.
 * This is a message-queue PRODUCER for learning asynchronous UI events.
 * ========================================================================== */

#include <zephyr/kernel.h>
#include <zephyr/sys/printk.h>
#include <zephyr/sys/util.h>

#include <stdint.h>

#include "app_events.h"
#include "emoji_draw.h"

#define NOTIFICATION_INTERVAL_SECONDS 15

struct demo_notification
{
    enum emoji_type icon;
    const char* description;
};

static const struct demo_notification notifications[] = {
    { EMOJI_BELL, "New alert" },
    { EMOJI_WIFI, "Wi-Fi demo" },
    { EMOJI_BATTERY, "Battery demo" },
    { EMOJI_RAIN, "Rain demo" },
    { EMOJI_HEART, "Heart demo" }
};

void notification_thread_entry(void* arg1, void* arg2, void* arg3)
{
    size_t index = 0U;

    ARG_UNUSED(arg1);
    ARG_UNUSED(arg2);
    ARG_UNUSED(arg3);

    printk("NOTIFY: simulation thread started\n");

    while(true)
    {
        struct app_event event;
        int rc;

        k_sleep(K_SECONDS(NOTIFICATION_INTERVAL_SECONDS));

        event.type         = APP_EVENT_NOTIFICATION;
        event.source       = APP_EVENT_SOURCE_SYSTEM;
        event.value        = (int32_t)notifications[index].icon;
        event.timestamp_ms = k_uptime_get_32();

        rc = k_msgq_put(&app_event_queue, &event, K_NO_WAIT);
        if(rc == 0)
        {
            printk("NOTIFY: queued %s\n", notifications[index].description);
        }
        else
        {
            printk("NOTIFY: queue full, notification dropped (%d)\n", rc);
        }

        index = (index + 1U) % ARRAY_SIZE(notifications);
    }
}
```
